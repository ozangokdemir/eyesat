.ifndef INCLUDED_CYFITTERGNU_INC
.set INCLUDED_CYFITTERGNU_INC, 1
.include "cydevicegnu_trm.inc"

/* M0 */
.set M0__0__DM__MASK, 0x07
.set M0__0__DM__SHIFT, 0
.set M0__0__DR, CYREG_PRT0_DR
.set M0__0__HSIOM, CYREG_HSIOM_PORT_SEL0
.set M0__0__HSIOM_MASK, 0x0000000F
.set M0__0__HSIOM_SHIFT, 0
.set M0__0__INTCFG, CYREG_PRT0_INTCFG
.set M0__0__INTSTAT, CYREG_PRT0_INTSTAT
.set M0__0__MASK, 0x01
.set M0__0__OUT_SEL, CYREG_UDB_PA0_CFG10
.set M0__0__OUT_SEL_SHIFT, 0
.set M0__0__OUT_SEL_VAL, 3
.set M0__0__PA__CFG0, CYREG_UDB_PA0_CFG0
.set M0__0__PA__CFG1, CYREG_UDB_PA0_CFG1
.set M0__0__PA__CFG10, CYREG_UDB_PA0_CFG10
.set M0__0__PA__CFG11, CYREG_UDB_PA0_CFG11
.set M0__0__PA__CFG12, CYREG_UDB_PA0_CFG12
.set M0__0__PA__CFG13, CYREG_UDB_PA0_CFG13
.set M0__0__PA__CFG14, CYREG_UDB_PA0_CFG14
.set M0__0__PA__CFG2, CYREG_UDB_PA0_CFG2
.set M0__0__PA__CFG3, CYREG_UDB_PA0_CFG3
.set M0__0__PA__CFG4, CYREG_UDB_PA0_CFG4
.set M0__0__PA__CFG5, CYREG_UDB_PA0_CFG5
.set M0__0__PA__CFG6, CYREG_UDB_PA0_CFG6
.set M0__0__PA__CFG7, CYREG_UDB_PA0_CFG7
.set M0__0__PA__CFG8, CYREG_UDB_PA0_CFG8
.set M0__0__PA__CFG9, CYREG_UDB_PA0_CFG9
.set M0__0__PC, CYREG_PRT0_PC
.set M0__0__PC2, CYREG_PRT0_PC2
.set M0__0__PORT, 0
.set M0__0__PS, CYREG_PRT0_PS
.set M0__0__SHIFT, 0
.set M0__DR, CYREG_PRT0_DR
.set M0__INTCFG, CYREG_PRT0_INTCFG
.set M0__INTSTAT, CYREG_PRT0_INTSTAT
.set M0__MASK, 0x01
.set M0__PA__CFG0, CYREG_UDB_PA0_CFG0
.set M0__PA__CFG1, CYREG_UDB_PA0_CFG1
.set M0__PA__CFG10, CYREG_UDB_PA0_CFG10
.set M0__PA__CFG11, CYREG_UDB_PA0_CFG11
.set M0__PA__CFG12, CYREG_UDB_PA0_CFG12
.set M0__PA__CFG13, CYREG_UDB_PA0_CFG13
.set M0__PA__CFG14, CYREG_UDB_PA0_CFG14
.set M0__PA__CFG2, CYREG_UDB_PA0_CFG2
.set M0__PA__CFG3, CYREG_UDB_PA0_CFG3
.set M0__PA__CFG4, CYREG_UDB_PA0_CFG4
.set M0__PA__CFG5, CYREG_UDB_PA0_CFG5
.set M0__PA__CFG6, CYREG_UDB_PA0_CFG6
.set M0__PA__CFG7, CYREG_UDB_PA0_CFG7
.set M0__PA__CFG8, CYREG_UDB_PA0_CFG8
.set M0__PA__CFG9, CYREG_UDB_PA0_CFG9
.set M0__PC, CYREG_PRT0_PC
.set M0__PC2, CYREG_PRT0_PC2
.set M0__PORT, 0
.set M0__PS, CYREG_PRT0_PS
.set M0__SHIFT, 0

/* M1 */
.set M1__0__DM__MASK, 0x07
.set M1__0__DM__SHIFT, 0
.set M1__0__DR, CYREG_PRT1_DR
.set M1__0__HSIOM, CYREG_HSIOM_PORT_SEL1
.set M1__0__HSIOM_MASK, 0x0000000F
.set M1__0__HSIOM_SHIFT, 0
.set M1__0__INTCFG, CYREG_PRT1_INTCFG
.set M1__0__INTSTAT, CYREG_PRT1_INTSTAT
.set M1__0__MASK, 0x01
.set M1__0__OUT_SEL, CYREG_UDB_PA1_CFG10
.set M1__0__OUT_SEL_SHIFT, 0
.set M1__0__OUT_SEL_VAL, 3
.set M1__0__PA__CFG0, CYREG_UDB_PA1_CFG0
.set M1__0__PA__CFG1, CYREG_UDB_PA1_CFG1
.set M1__0__PA__CFG10, CYREG_UDB_PA1_CFG10
.set M1__0__PA__CFG11, CYREG_UDB_PA1_CFG11
.set M1__0__PA__CFG12, CYREG_UDB_PA1_CFG12
.set M1__0__PA__CFG13, CYREG_UDB_PA1_CFG13
.set M1__0__PA__CFG14, CYREG_UDB_PA1_CFG14
.set M1__0__PA__CFG2, CYREG_UDB_PA1_CFG2
.set M1__0__PA__CFG3, CYREG_UDB_PA1_CFG3
.set M1__0__PA__CFG4, CYREG_UDB_PA1_CFG4
.set M1__0__PA__CFG5, CYREG_UDB_PA1_CFG5
.set M1__0__PA__CFG6, CYREG_UDB_PA1_CFG6
.set M1__0__PA__CFG7, CYREG_UDB_PA1_CFG7
.set M1__0__PA__CFG8, CYREG_UDB_PA1_CFG8
.set M1__0__PA__CFG9, CYREG_UDB_PA1_CFG9
.set M1__0__PC, CYREG_PRT1_PC
.set M1__0__PC2, CYREG_PRT1_PC2
.set M1__0__PORT, 1
.set M1__0__PS, CYREG_PRT1_PS
.set M1__0__SHIFT, 0
.set M1__DR, CYREG_PRT1_DR
.set M1__INTCFG, CYREG_PRT1_INTCFG
.set M1__INTSTAT, CYREG_PRT1_INTSTAT
.set M1__MASK, 0x01
.set M1__PA__CFG0, CYREG_UDB_PA1_CFG0
.set M1__PA__CFG1, CYREG_UDB_PA1_CFG1
.set M1__PA__CFG10, CYREG_UDB_PA1_CFG10
.set M1__PA__CFG11, CYREG_UDB_PA1_CFG11
.set M1__PA__CFG12, CYREG_UDB_PA1_CFG12
.set M1__PA__CFG13, CYREG_UDB_PA1_CFG13
.set M1__PA__CFG14, CYREG_UDB_PA1_CFG14
.set M1__PA__CFG2, CYREG_UDB_PA1_CFG2
.set M1__PA__CFG3, CYREG_UDB_PA1_CFG3
.set M1__PA__CFG4, CYREG_UDB_PA1_CFG4
.set M1__PA__CFG5, CYREG_UDB_PA1_CFG5
.set M1__PA__CFG6, CYREG_UDB_PA1_CFG6
.set M1__PA__CFG7, CYREG_UDB_PA1_CFG7
.set M1__PA__CFG8, CYREG_UDB_PA1_CFG8
.set M1__PA__CFG9, CYREG_UDB_PA1_CFG9
.set M1__PC, CYREG_PRT1_PC
.set M1__PC2, CYREG_PRT1_PC2
.set M1__PORT, 1
.set M1__PS, CYREG_PRT1_PS
.set M1__SHIFT, 0

/* DIR */
.set DIR__0__DM__MASK, 0xE00
.set DIR__0__DM__SHIFT, 9
.set DIR__0__DR, CYREG_PRT0_DR
.set DIR__0__HSIOM, CYREG_HSIOM_PORT_SEL0
.set DIR__0__HSIOM_MASK, 0x0000F000
.set DIR__0__HSIOM_SHIFT, 12
.set DIR__0__INTCFG, CYREG_PRT0_INTCFG
.set DIR__0__INTSTAT, CYREG_PRT0_INTSTAT
.set DIR__0__MASK, 0x08
.set DIR__0__OUT_SEL, CYREG_UDB_PA0_CFG10
.set DIR__0__OUT_SEL_SHIFT, 6
.set DIR__0__OUT_SEL_VAL, 1
.set DIR__0__PA__CFG0, CYREG_UDB_PA0_CFG0
.set DIR__0__PA__CFG1, CYREG_UDB_PA0_CFG1
.set DIR__0__PA__CFG10, CYREG_UDB_PA0_CFG10
.set DIR__0__PA__CFG11, CYREG_UDB_PA0_CFG11
.set DIR__0__PA__CFG12, CYREG_UDB_PA0_CFG12
.set DIR__0__PA__CFG13, CYREG_UDB_PA0_CFG13
.set DIR__0__PA__CFG14, CYREG_UDB_PA0_CFG14
.set DIR__0__PA__CFG2, CYREG_UDB_PA0_CFG2
.set DIR__0__PA__CFG3, CYREG_UDB_PA0_CFG3
.set DIR__0__PA__CFG4, CYREG_UDB_PA0_CFG4
.set DIR__0__PA__CFG5, CYREG_UDB_PA0_CFG5
.set DIR__0__PA__CFG6, CYREG_UDB_PA0_CFG6
.set DIR__0__PA__CFG7, CYREG_UDB_PA0_CFG7
.set DIR__0__PA__CFG8, CYREG_UDB_PA0_CFG8
.set DIR__0__PA__CFG9, CYREG_UDB_PA0_CFG9
.set DIR__0__PC, CYREG_PRT0_PC
.set DIR__0__PC2, CYREG_PRT0_PC2
.set DIR__0__PORT, 0
.set DIR__0__PS, CYREG_PRT0_PS
.set DIR__0__SHIFT, 3
.set DIR__DR, CYREG_PRT0_DR
.set DIR__INTCFG, CYREG_PRT0_INTCFG
.set DIR__INTSTAT, CYREG_PRT0_INTSTAT
.set DIR__MASK, 0x08
.set DIR__PA__CFG0, CYREG_UDB_PA0_CFG0
.set DIR__PA__CFG1, CYREG_UDB_PA0_CFG1
.set DIR__PA__CFG10, CYREG_UDB_PA0_CFG10
.set DIR__PA__CFG11, CYREG_UDB_PA0_CFG11
.set DIR__PA__CFG12, CYREG_UDB_PA0_CFG12
.set DIR__PA__CFG13, CYREG_UDB_PA0_CFG13
.set DIR__PA__CFG14, CYREG_UDB_PA0_CFG14
.set DIR__PA__CFG2, CYREG_UDB_PA0_CFG2
.set DIR__PA__CFG3, CYREG_UDB_PA0_CFG3
.set DIR__PA__CFG4, CYREG_UDB_PA0_CFG4
.set DIR__PA__CFG5, CYREG_UDB_PA0_CFG5
.set DIR__PA__CFG6, CYREG_UDB_PA0_CFG6
.set DIR__PA__CFG7, CYREG_UDB_PA0_CFG7
.set DIR__PA__CFG8, CYREG_UDB_PA0_CFG8
.set DIR__PA__CFG9, CYREG_UDB_PA0_CFG9
.set DIR__PC, CYREG_PRT0_PC
.set DIR__PC2, CYREG_PRT0_PC2
.set DIR__PORT, 0
.set DIR__PS, CYREG_PRT0_PS
.set DIR__SHIFT, 3

/* PWM_PWMUDB */
.set PWM_PWMUDB_genblk1_ctrlreg__16BIT_CONTROL_AUX_CTL_REG, CYREG_UDB_W16_ACTL_02
.set PWM_PWMUDB_genblk1_ctrlreg__16BIT_CONTROL_CONTROL_REG, CYREG_UDB_W16_CTL_02
.set PWM_PWMUDB_genblk1_ctrlreg__16BIT_CONTROL_COUNT_REG, CYREG_UDB_W16_CTL_02
.set PWM_PWMUDB_genblk1_ctrlreg__16BIT_COUNT_CONTROL_REG, CYREG_UDB_W16_CTL_02
.set PWM_PWMUDB_genblk1_ctrlreg__16BIT_COUNT_COUNT_REG, CYREG_UDB_W16_CTL_02
.set PWM_PWMUDB_genblk1_ctrlreg__16BIT_MASK_MASK_REG, CYREG_UDB_W16_MSK_02
.set PWM_PWMUDB_genblk1_ctrlreg__16BIT_MASK_PERIOD_REG, CYREG_UDB_W16_MSK_02
.set PWM_PWMUDB_genblk1_ctrlreg__16BIT_PERIOD_MASK_REG, CYREG_UDB_W16_MSK_02
.set PWM_PWMUDB_genblk1_ctrlreg__16BIT_PERIOD_PERIOD_REG, CYREG_UDB_W16_MSK_02
.set PWM_PWMUDB_genblk1_ctrlreg__7__MASK, 0x80
.set PWM_PWMUDB_genblk1_ctrlreg__7__POS, 7
.set PWM_PWMUDB_genblk1_ctrlreg__CONTROL_AUX_CTL_REG, CYREG_UDB_W8_ACTL_02
.set PWM_PWMUDB_genblk1_ctrlreg__CONTROL_REG, CYREG_UDB_W8_CTL_02
.set PWM_PWMUDB_genblk1_ctrlreg__CONTROL_ST_REG, CYREG_UDB_CAT16_CTL_ST_02
.set PWM_PWMUDB_genblk1_ctrlreg__COUNT_REG, CYREG_UDB_W8_CTL_02
.set PWM_PWMUDB_genblk1_ctrlreg__COUNT_ST_REG, CYREG_UDB_CAT16_CTL_ST_02
.set PWM_PWMUDB_genblk1_ctrlreg__MASK, 0x80
.set PWM_PWMUDB_genblk1_ctrlreg__MASK_CTL_AUX_CTL_REG, CYREG_UDB_CAT16_ACTL_MSK_02
.set PWM_PWMUDB_genblk1_ctrlreg__PER_CTL_AUX_CTL_REG, CYREG_UDB_CAT16_ACTL_MSK_02
.set PWM_PWMUDB_genblk1_ctrlreg__PERIOD_REG, CYREG_UDB_W8_MSK_02
.set PWM_PWMUDB_sP16_pwmdp_u0__16BIT_A0_REG, CYREG_UDB_W16_A0_02
.set PWM_PWMUDB_sP16_pwmdp_u0__16BIT_A1_REG, CYREG_UDB_W16_A1_02
.set PWM_PWMUDB_sP16_pwmdp_u0__16BIT_D0_REG, CYREG_UDB_W16_D0_02
.set PWM_PWMUDB_sP16_pwmdp_u0__16BIT_D1_REG, CYREG_UDB_W16_D1_02
.set PWM_PWMUDB_sP16_pwmdp_u0__16BIT_DP_AUX_CTL_REG, CYREG_UDB_W16_ACTL_02
.set PWM_PWMUDB_sP16_pwmdp_u0__16BIT_F0_REG, CYREG_UDB_W16_F0_02
.set PWM_PWMUDB_sP16_pwmdp_u0__16BIT_F1_REG, CYREG_UDB_W16_F1_02
.set PWM_PWMUDB_sP16_pwmdp_u0__A0_A1_REG, CYREG_UDB_CAT16_A_02
.set PWM_PWMUDB_sP16_pwmdp_u0__A0_REG, CYREG_UDB_W8_A0_02
.set PWM_PWMUDB_sP16_pwmdp_u0__A1_REG, CYREG_UDB_W8_A1_02
.set PWM_PWMUDB_sP16_pwmdp_u0__D0_D1_REG, CYREG_UDB_CAT16_D_02
.set PWM_PWMUDB_sP16_pwmdp_u0__D0_REG, CYREG_UDB_W8_D0_02
.set PWM_PWMUDB_sP16_pwmdp_u0__D1_REG, CYREG_UDB_W8_D1_02
.set PWM_PWMUDB_sP16_pwmdp_u0__DP_AUX_CTL_REG, CYREG_UDB_W8_ACTL_02
.set PWM_PWMUDB_sP16_pwmdp_u0__F0_F1_REG, CYREG_UDB_CAT16_F_02
.set PWM_PWMUDB_sP16_pwmdp_u0__F0_REG, CYREG_UDB_W8_F0_02
.set PWM_PWMUDB_sP16_pwmdp_u0__F1_REG, CYREG_UDB_W8_F1_02
.set PWM_PWMUDB_sP16_pwmdp_u0__MSK_DP_AUX_CTL_REG, CYREG_UDB_CAT16_ACTL_MSK_02
.set PWM_PWMUDB_sP16_pwmdp_u0__PER_DP_AUX_CTL_REG, CYREG_UDB_CAT16_ACTL_MSK_02
.set PWM_PWMUDB_sP16_pwmdp_u1__A0_A1_REG, CYREG_UDB_CAT16_A_03
.set PWM_PWMUDB_sP16_pwmdp_u1__A0_REG, CYREG_UDB_W8_A0_03
.set PWM_PWMUDB_sP16_pwmdp_u1__A1_REG, CYREG_UDB_W8_A1_03
.set PWM_PWMUDB_sP16_pwmdp_u1__D0_D1_REG, CYREG_UDB_CAT16_D_03
.set PWM_PWMUDB_sP16_pwmdp_u1__D0_REG, CYREG_UDB_W8_D0_03
.set PWM_PWMUDB_sP16_pwmdp_u1__D1_REG, CYREG_UDB_W8_D1_03
.set PWM_PWMUDB_sP16_pwmdp_u1__DP_AUX_CTL_REG, CYREG_UDB_W8_ACTL_03
.set PWM_PWMUDB_sP16_pwmdp_u1__F0_F1_REG, CYREG_UDB_CAT16_F_03
.set PWM_PWMUDB_sP16_pwmdp_u1__F0_REG, CYREG_UDB_W8_F0_03
.set PWM_PWMUDB_sP16_pwmdp_u1__F1_REG, CYREG_UDB_W8_F1_03

/* nEN */
.set nEN__0__DM__MASK, 0x38000
.set nEN__0__DM__SHIFT, 15
.set nEN__0__DR, CYREG_PRT0_DR
.set nEN__0__HSIOM, CYREG_HSIOM_PORT_SEL0
.set nEN__0__HSIOM_MASK, 0x00F00000
.set nEN__0__HSIOM_SHIFT, 20
.set nEN__0__INTCFG, CYREG_PRT0_INTCFG
.set nEN__0__INTSTAT, CYREG_PRT0_INTSTAT
.set nEN__0__MASK, 0x20
.set nEN__0__OUT_SEL, CYREG_UDB_PA0_CFG10
.set nEN__0__OUT_SEL_SHIFT, 10
.set nEN__0__OUT_SEL_VAL, 1
.set nEN__0__PA__CFG0, CYREG_UDB_PA0_CFG0
.set nEN__0__PA__CFG1, CYREG_UDB_PA0_CFG1
.set nEN__0__PA__CFG10, CYREG_UDB_PA0_CFG10
.set nEN__0__PA__CFG11, CYREG_UDB_PA0_CFG11
.set nEN__0__PA__CFG12, CYREG_UDB_PA0_CFG12
.set nEN__0__PA__CFG13, CYREG_UDB_PA0_CFG13
.set nEN__0__PA__CFG14, CYREG_UDB_PA0_CFG14
.set nEN__0__PA__CFG2, CYREG_UDB_PA0_CFG2
.set nEN__0__PA__CFG3, CYREG_UDB_PA0_CFG3
.set nEN__0__PA__CFG4, CYREG_UDB_PA0_CFG4
.set nEN__0__PA__CFG5, CYREG_UDB_PA0_CFG5
.set nEN__0__PA__CFG6, CYREG_UDB_PA0_CFG6
.set nEN__0__PA__CFG7, CYREG_UDB_PA0_CFG7
.set nEN__0__PA__CFG8, CYREG_UDB_PA0_CFG8
.set nEN__0__PA__CFG9, CYREG_UDB_PA0_CFG9
.set nEN__0__PC, CYREG_PRT0_PC
.set nEN__0__PC2, CYREG_PRT0_PC2
.set nEN__0__PORT, 0
.set nEN__0__PS, CYREG_PRT0_PS
.set nEN__0__SHIFT, 5
.set nEN__DR, CYREG_PRT0_DR
.set nEN__INTCFG, CYREG_PRT0_INTCFG
.set nEN__INTSTAT, CYREG_PRT0_INTSTAT
.set nEN__MASK, 0x20
.set nEN__PA__CFG0, CYREG_UDB_PA0_CFG0
.set nEN__PA__CFG1, CYREG_UDB_PA0_CFG1
.set nEN__PA__CFG10, CYREG_UDB_PA0_CFG10
.set nEN__PA__CFG11, CYREG_UDB_PA0_CFG11
.set nEN__PA__CFG12, CYREG_UDB_PA0_CFG12
.set nEN__PA__CFG13, CYREG_UDB_PA0_CFG13
.set nEN__PA__CFG14, CYREG_UDB_PA0_CFG14
.set nEN__PA__CFG2, CYREG_UDB_PA0_CFG2
.set nEN__PA__CFG3, CYREG_UDB_PA0_CFG3
.set nEN__PA__CFG4, CYREG_UDB_PA0_CFG4
.set nEN__PA__CFG5, CYREG_UDB_PA0_CFG5
.set nEN__PA__CFG6, CYREG_UDB_PA0_CFG6
.set nEN__PA__CFG7, CYREG_UDB_PA0_CFG7
.set nEN__PA__CFG8, CYREG_UDB_PA0_CFG8
.set nEN__PA__CFG9, CYREG_UDB_PA0_CFG9
.set nEN__PC, CYREG_PRT0_PC
.set nEN__PC2, CYREG_PRT0_PC2
.set nEN__PORT, 0
.set nEN__PS, CYREG_PRT0_PS
.set nEN__SHIFT, 5

/* I2CS_SCB */
.set I2CS_SCB__BIST_CONTROL, CYREG_SCB0_BIST_CONTROL
.set I2CS_SCB__BIST_DATA, CYREG_SCB0_BIST_DATA
.set I2CS_SCB__CTRL, CYREG_SCB0_CTRL
.set I2CS_SCB__EZ_DATA00, CYREG_SCB0_EZ_DATA00
.set I2CS_SCB__EZ_DATA01, CYREG_SCB0_EZ_DATA01
.set I2CS_SCB__EZ_DATA02, CYREG_SCB0_EZ_DATA02
.set I2CS_SCB__EZ_DATA03, CYREG_SCB0_EZ_DATA03
.set I2CS_SCB__EZ_DATA04, CYREG_SCB0_EZ_DATA04
.set I2CS_SCB__EZ_DATA05, CYREG_SCB0_EZ_DATA05
.set I2CS_SCB__EZ_DATA06, CYREG_SCB0_EZ_DATA06
.set I2CS_SCB__EZ_DATA07, CYREG_SCB0_EZ_DATA07
.set I2CS_SCB__EZ_DATA08, CYREG_SCB0_EZ_DATA08
.set I2CS_SCB__EZ_DATA09, CYREG_SCB0_EZ_DATA09
.set I2CS_SCB__EZ_DATA10, CYREG_SCB0_EZ_DATA10
.set I2CS_SCB__EZ_DATA11, CYREG_SCB0_EZ_DATA11
.set I2CS_SCB__EZ_DATA12, CYREG_SCB0_EZ_DATA12
.set I2CS_SCB__EZ_DATA13, CYREG_SCB0_EZ_DATA13
.set I2CS_SCB__EZ_DATA14, CYREG_SCB0_EZ_DATA14
.set I2CS_SCB__EZ_DATA15, CYREG_SCB0_EZ_DATA15
.set I2CS_SCB__EZ_DATA16, CYREG_SCB0_EZ_DATA16
.set I2CS_SCB__EZ_DATA17, CYREG_SCB0_EZ_DATA17
.set I2CS_SCB__EZ_DATA18, CYREG_SCB0_EZ_DATA18
.set I2CS_SCB__EZ_DATA19, CYREG_SCB0_EZ_DATA19
.set I2CS_SCB__EZ_DATA20, CYREG_SCB0_EZ_DATA20
.set I2CS_SCB__EZ_DATA21, CYREG_SCB0_EZ_DATA21
.set I2CS_SCB__EZ_DATA22, CYREG_SCB0_EZ_DATA22
.set I2CS_SCB__EZ_DATA23, CYREG_SCB0_EZ_DATA23
.set I2CS_SCB__EZ_DATA24, CYREG_SCB0_EZ_DATA24
.set I2CS_SCB__EZ_DATA25, CYREG_SCB0_EZ_DATA25
.set I2CS_SCB__EZ_DATA26, CYREG_SCB0_EZ_DATA26
.set I2CS_SCB__EZ_DATA27, CYREG_SCB0_EZ_DATA27
.set I2CS_SCB__EZ_DATA28, CYREG_SCB0_EZ_DATA28
.set I2CS_SCB__EZ_DATA29, CYREG_SCB0_EZ_DATA29
.set I2CS_SCB__EZ_DATA30, CYREG_SCB0_EZ_DATA30
.set I2CS_SCB__EZ_DATA31, CYREG_SCB0_EZ_DATA31
.set I2CS_SCB__I2C_CFG, CYREG_SCB0_I2C_CFG
.set I2CS_SCB__I2C_CTRL, CYREG_SCB0_I2C_CTRL
.set I2CS_SCB__I2C_M_CMD, CYREG_SCB0_I2C_M_CMD
.set I2CS_SCB__I2C_S_CMD, CYREG_SCB0_I2C_S_CMD
.set I2CS_SCB__I2C_STATUS, CYREG_SCB0_I2C_STATUS
.set I2CS_SCB__INTR_CAUSE, CYREG_SCB0_INTR_CAUSE
.set I2CS_SCB__INTR_I2C_EC, CYREG_SCB0_INTR_I2C_EC
.set I2CS_SCB__INTR_I2C_EC_MASK, CYREG_SCB0_INTR_I2C_EC_MASK
.set I2CS_SCB__INTR_I2C_EC_MASKED, CYREG_SCB0_INTR_I2C_EC_MASKED
.set I2CS_SCB__INTR_M, CYREG_SCB0_INTR_M
.set I2CS_SCB__INTR_M_MASK, CYREG_SCB0_INTR_M_MASK
.set I2CS_SCB__INTR_M_MASKED, CYREG_SCB0_INTR_M_MASKED
.set I2CS_SCB__INTR_M_SET, CYREG_SCB0_INTR_M_SET
.set I2CS_SCB__INTR_RX, CYREG_SCB0_INTR_RX
.set I2CS_SCB__INTR_RX_MASK, CYREG_SCB0_INTR_RX_MASK
.set I2CS_SCB__INTR_RX_MASKED, CYREG_SCB0_INTR_RX_MASKED
.set I2CS_SCB__INTR_RX_SET, CYREG_SCB0_INTR_RX_SET
.set I2CS_SCB__INTR_S, CYREG_SCB0_INTR_S
.set I2CS_SCB__INTR_S_MASK, CYREG_SCB0_INTR_S_MASK
.set I2CS_SCB__INTR_S_MASKED, CYREG_SCB0_INTR_S_MASKED
.set I2CS_SCB__INTR_S_SET, CYREG_SCB0_INTR_S_SET
.set I2CS_SCB__INTR_SPI_EC, CYREG_SCB0_INTR_SPI_EC
.set I2CS_SCB__INTR_SPI_EC_MASK, CYREG_SCB0_INTR_SPI_EC_MASK
.set I2CS_SCB__INTR_SPI_EC_MASKED, CYREG_SCB0_INTR_SPI_EC_MASKED
.set I2CS_SCB__INTR_TX, CYREG_SCB0_INTR_TX
.set I2CS_SCB__INTR_TX_MASK, CYREG_SCB0_INTR_TX_MASK
.set I2CS_SCB__INTR_TX_MASKED, CYREG_SCB0_INTR_TX_MASKED
.set I2CS_SCB__INTR_TX_SET, CYREG_SCB0_INTR_TX_SET
.set I2CS_SCB__RX_CTRL, CYREG_SCB0_RX_CTRL
.set I2CS_SCB__RX_FIFO_CTRL, CYREG_SCB0_RX_FIFO_CTRL
.set I2CS_SCB__RX_FIFO_RD, CYREG_SCB0_RX_FIFO_RD
.set I2CS_SCB__RX_FIFO_RD_SILENT, CYREG_SCB0_RX_FIFO_RD_SILENT
.set I2CS_SCB__RX_FIFO_STATUS, CYREG_SCB0_RX_FIFO_STATUS
.set I2CS_SCB__RX_MATCH, CYREG_SCB0_RX_MATCH
.set I2CS_SCB__SPI_CTRL, CYREG_SCB0_SPI_CTRL
.set I2CS_SCB__SPI_STATUS, CYREG_SCB0_SPI_STATUS
.set I2CS_SCB__STATUS, CYREG_SCB0_STATUS
.set I2CS_SCB__TX_CTRL, CYREG_SCB0_TX_CTRL
.set I2CS_SCB__TX_FIFO_CTRL, CYREG_SCB0_TX_FIFO_CTRL
.set I2CS_SCB__TX_FIFO_STATUS, CYREG_SCB0_TX_FIFO_STATUS
.set I2CS_SCB__TX_FIFO_WR, CYREG_SCB0_TX_FIFO_WR
.set I2CS_SCB__UART_CTRL, CYREG_SCB0_UART_CTRL
.set I2CS_SCB__UART_RX_CTRL, CYREG_SCB0_UART_RX_CTRL
.set I2CS_SCB__UART_RX_STATUS, CYREG_SCB0_UART_RX_STATUS
.set I2CS_SCB__UART_TX_CTRL, CYREG_SCB0_UART_TX_CTRL

/* I2CS_SCB_IRQ */
.set I2CS_SCB_IRQ__INTC_CLR_EN_REG, CYREG_CM0_ICER
.set I2CS_SCB_IRQ__INTC_CLR_PD_REG, CYREG_CM0_ICPR
.set I2CS_SCB_IRQ__INTC_MASK, 0x400
.set I2CS_SCB_IRQ__INTC_NUMBER, 10
.set I2CS_SCB_IRQ__INTC_PRIOR_MASK, 0xC00000
.set I2CS_SCB_IRQ__INTC_PRIOR_NUM, 3
.set I2CS_SCB_IRQ__INTC_PRIOR_REG, CYREG_CM0_IPR2
.set I2CS_SCB_IRQ__INTC_SET_EN_REG, CYREG_CM0_ISER
.set I2CS_SCB_IRQ__INTC_SET_PD_REG, CYREG_CM0_ISPR

/* I2CS_SCBCLK */
.set I2CS_SCBCLK__DIVIDER_MASK, 0x0000FFFF
.set I2CS_SCBCLK__ENABLE, CYREG_CLK_DIVIDER_A00
.set I2CS_SCBCLK__ENABLE_MASK, 0x80000000
.set I2CS_SCBCLK__MASK, 0x80000000
.set I2CS_SCBCLK__REGISTER, CYREG_CLK_DIVIDER_A00

/* I2CS_scl */
.set I2CS_scl__0__DM__MASK, 0x07
.set I2CS_scl__0__DM__SHIFT, 0
.set I2CS_scl__0__DR, CYREG_PRT4_DR
.set I2CS_scl__0__HSIOM, CYREG_HSIOM_PORT_SEL4
.set I2CS_scl__0__HSIOM_MASK, 0x0000000F
.set I2CS_scl__0__HSIOM_SHIFT, 0
.set I2CS_scl__0__INTCFG, CYREG_PRT4_INTCFG
.set I2CS_scl__0__INTSTAT, CYREG_PRT4_INTSTAT
.set I2CS_scl__0__MASK, 0x01
.set I2CS_scl__0__PC, CYREG_PRT4_PC
.set I2CS_scl__0__PC2, CYREG_PRT4_PC2
.set I2CS_scl__0__PORT, 4
.set I2CS_scl__0__PS, CYREG_PRT4_PS
.set I2CS_scl__0__SHIFT, 0
.set I2CS_scl__DR, CYREG_PRT4_DR
.set I2CS_scl__INTCFG, CYREG_PRT4_INTCFG
.set I2CS_scl__INTSTAT, CYREG_PRT4_INTSTAT
.set I2CS_scl__MASK, 0x01
.set I2CS_scl__PC, CYREG_PRT4_PC
.set I2CS_scl__PC2, CYREG_PRT4_PC2
.set I2CS_scl__PORT, 4
.set I2CS_scl__PS, CYREG_PRT4_PS
.set I2CS_scl__SHIFT, 0

/* I2CS_sda */
.set I2CS_sda__0__DM__MASK, 0x38
.set I2CS_sda__0__DM__SHIFT, 3
.set I2CS_sda__0__DR, CYREG_PRT4_DR
.set I2CS_sda__0__HSIOM, CYREG_HSIOM_PORT_SEL4
.set I2CS_sda__0__HSIOM_MASK, 0x000000F0
.set I2CS_sda__0__HSIOM_SHIFT, 4
.set I2CS_sda__0__INTCFG, CYREG_PRT4_INTCFG
.set I2CS_sda__0__INTSTAT, CYREG_PRT4_INTSTAT
.set I2CS_sda__0__MASK, 0x02
.set I2CS_sda__0__PC, CYREG_PRT4_PC
.set I2CS_sda__0__PC2, CYREG_PRT4_PC2
.set I2CS_sda__0__PORT, 4
.set I2CS_sda__0__PS, CYREG_PRT4_PS
.set I2CS_sda__0__SHIFT, 1
.set I2CS_sda__DR, CYREG_PRT4_DR
.set I2CS_sda__INTCFG, CYREG_PRT4_INTCFG
.set I2CS_sda__INTSTAT, CYREG_PRT4_INTSTAT
.set I2CS_sda__MASK, 0x02
.set I2CS_sda__PC, CYREG_PRT4_PC
.set I2CS_sda__PC2, CYREG_PRT4_PC2
.set I2CS_sda__PORT, 4
.set I2CS_sda__PS, CYREG_PRT4_PS
.set I2CS_sda__SHIFT, 1

/* STEP */
.set STEP__0__DM__MASK, 0x1C0000
.set STEP__0__DM__SHIFT, 18
.set STEP__0__DR, CYREG_PRT0_DR
.set STEP__0__HSIOM, CYREG_HSIOM_PORT_SEL0
.set STEP__0__HSIOM_MASK, 0x0F000000
.set STEP__0__HSIOM_SHIFT, 24
.set STEP__0__INTCFG, CYREG_PRT0_INTCFG
.set STEP__0__INTSTAT, CYREG_PRT0_INTSTAT
.set STEP__0__MASK, 0x40
.set STEP__0__OUT_SEL, CYREG_UDB_PA0_CFG10
.set STEP__0__OUT_SEL_SHIFT, 12
.set STEP__0__OUT_SEL_VAL, 3
.set STEP__0__PA__CFG0, CYREG_UDB_PA0_CFG0
.set STEP__0__PA__CFG1, CYREG_UDB_PA0_CFG1
.set STEP__0__PA__CFG10, CYREG_UDB_PA0_CFG10
.set STEP__0__PA__CFG11, CYREG_UDB_PA0_CFG11
.set STEP__0__PA__CFG12, CYREG_UDB_PA0_CFG12
.set STEP__0__PA__CFG13, CYREG_UDB_PA0_CFG13
.set STEP__0__PA__CFG14, CYREG_UDB_PA0_CFG14
.set STEP__0__PA__CFG2, CYREG_UDB_PA0_CFG2
.set STEP__0__PA__CFG3, CYREG_UDB_PA0_CFG3
.set STEP__0__PA__CFG4, CYREG_UDB_PA0_CFG4
.set STEP__0__PA__CFG5, CYREG_UDB_PA0_CFG5
.set STEP__0__PA__CFG6, CYREG_UDB_PA0_CFG6
.set STEP__0__PA__CFG7, CYREG_UDB_PA0_CFG7
.set STEP__0__PA__CFG8, CYREG_UDB_PA0_CFG8
.set STEP__0__PA__CFG9, CYREG_UDB_PA0_CFG9
.set STEP__0__PC, CYREG_PRT0_PC
.set STEP__0__PC2, CYREG_PRT0_PC2
.set STEP__0__PORT, 0
.set STEP__0__PS, CYREG_PRT0_PS
.set STEP__0__SHIFT, 6
.set STEP__DR, CYREG_PRT0_DR
.set STEP__INTCFG, CYREG_PRT0_INTCFG
.set STEP__INTSTAT, CYREG_PRT0_INTSTAT
.set STEP__MASK, 0x40
.set STEP__PA__CFG0, CYREG_UDB_PA0_CFG0
.set STEP__PA__CFG1, CYREG_UDB_PA0_CFG1
.set STEP__PA__CFG10, CYREG_UDB_PA0_CFG10
.set STEP__PA__CFG11, CYREG_UDB_PA0_CFG11
.set STEP__PA__CFG12, CYREG_UDB_PA0_CFG12
.set STEP__PA__CFG13, CYREG_UDB_PA0_CFG13
.set STEP__PA__CFG14, CYREG_UDB_PA0_CFG14
.set STEP__PA__CFG2, CYREG_UDB_PA0_CFG2
.set STEP__PA__CFG3, CYREG_UDB_PA0_CFG3
.set STEP__PA__CFG4, CYREG_UDB_PA0_CFG4
.set STEP__PA__CFG5, CYREG_UDB_PA0_CFG5
.set STEP__PA__CFG6, CYREG_UDB_PA0_CFG6
.set STEP__PA__CFG7, CYREG_UDB_PA0_CFG7
.set STEP__PA__CFG8, CYREG_UDB_PA0_CFG8
.set STEP__PA__CFG9, CYREG_UDB_PA0_CFG9
.set STEP__PC, CYREG_PRT0_PC
.set STEP__PC2, CYREG_PRT0_PC2
.set STEP__PORT, 0
.set STEP__PS, CYREG_PRT0_PS
.set STEP__SHIFT, 6

/* cap1 */
.set cap1__0__DM__MASK, 0xE00000
.set cap1__0__DM__SHIFT, 21
.set cap1__0__DR, CYREG_PRT0_DR
.set cap1__0__HSIOM, CYREG_HSIOM_PORT_SEL0
.set cap1__0__HSIOM_MASK, 0xF0000000
.set cap1__0__HSIOM_SHIFT, 28
.set cap1__0__INTCFG, CYREG_PRT0_INTCFG
.set cap1__0__INTSTAT, CYREG_PRT0_INTSTAT
.set cap1__0__MASK, 0x80
.set cap1__0__PA__CFG0, CYREG_UDB_PA0_CFG0
.set cap1__0__PA__CFG1, CYREG_UDB_PA0_CFG1
.set cap1__0__PA__CFG10, CYREG_UDB_PA0_CFG10
.set cap1__0__PA__CFG11, CYREG_UDB_PA0_CFG11
.set cap1__0__PA__CFG12, CYREG_UDB_PA0_CFG12
.set cap1__0__PA__CFG13, CYREG_UDB_PA0_CFG13
.set cap1__0__PA__CFG14, CYREG_UDB_PA0_CFG14
.set cap1__0__PA__CFG2, CYREG_UDB_PA0_CFG2
.set cap1__0__PA__CFG3, CYREG_UDB_PA0_CFG3
.set cap1__0__PA__CFG4, CYREG_UDB_PA0_CFG4
.set cap1__0__PA__CFG5, CYREG_UDB_PA0_CFG5
.set cap1__0__PA__CFG6, CYREG_UDB_PA0_CFG6
.set cap1__0__PA__CFG7, CYREG_UDB_PA0_CFG7
.set cap1__0__PA__CFG8, CYREG_UDB_PA0_CFG8
.set cap1__0__PA__CFG9, CYREG_UDB_PA0_CFG9
.set cap1__0__PC, CYREG_PRT0_PC
.set cap1__0__PC2, CYREG_PRT0_PC2
.set cap1__0__PORT, 0
.set cap1__0__PS, CYREG_PRT0_PS
.set cap1__0__SHIFT, 7
.set cap1__DR, CYREG_PRT0_DR
.set cap1__INTCFG, CYREG_PRT0_INTCFG
.set cap1__INTSTAT, CYREG_PRT0_INTSTAT
.set cap1__MASK, 0x80
.set cap1__PA__CFG0, CYREG_UDB_PA0_CFG0
.set cap1__PA__CFG1, CYREG_UDB_PA0_CFG1
.set cap1__PA__CFG10, CYREG_UDB_PA0_CFG10
.set cap1__PA__CFG11, CYREG_UDB_PA0_CFG11
.set cap1__PA__CFG12, CYREG_UDB_PA0_CFG12
.set cap1__PA__CFG13, CYREG_UDB_PA0_CFG13
.set cap1__PA__CFG14, CYREG_UDB_PA0_CFG14
.set cap1__PA__CFG2, CYREG_UDB_PA0_CFG2
.set cap1__PA__CFG3, CYREG_UDB_PA0_CFG3
.set cap1__PA__CFG4, CYREG_UDB_PA0_CFG4
.set cap1__PA__CFG5, CYREG_UDB_PA0_CFG5
.set cap1__PA__CFG6, CYREG_UDB_PA0_CFG6
.set cap1__PA__CFG7, CYREG_UDB_PA0_CFG7
.set cap1__PA__CFG8, CYREG_UDB_PA0_CFG8
.set cap1__PA__CFG9, CYREG_UDB_PA0_CFG9
.set cap1__PC, CYREG_PRT0_PC
.set cap1__PC2, CYREG_PRT0_PC2
.set cap1__PORT, 0
.set cap1__PS, CYREG_PRT0_PS
.set cap1__SHIFT, 7

/* cap2 */
.set cap2__0__DM__MASK, 0x7000
.set cap2__0__DM__SHIFT, 12
.set cap2__0__DR, CYREG_PRT0_DR
.set cap2__0__HSIOM, CYREG_HSIOM_PORT_SEL0
.set cap2__0__HSIOM_MASK, 0x000F0000
.set cap2__0__HSIOM_SHIFT, 16
.set cap2__0__INTCFG, CYREG_PRT0_INTCFG
.set cap2__0__INTSTAT, CYREG_PRT0_INTSTAT
.set cap2__0__MASK, 0x10
.set cap2__0__PA__CFG0, CYREG_UDB_PA0_CFG0
.set cap2__0__PA__CFG1, CYREG_UDB_PA0_CFG1
.set cap2__0__PA__CFG10, CYREG_UDB_PA0_CFG10
.set cap2__0__PA__CFG11, CYREG_UDB_PA0_CFG11
.set cap2__0__PA__CFG12, CYREG_UDB_PA0_CFG12
.set cap2__0__PA__CFG13, CYREG_UDB_PA0_CFG13
.set cap2__0__PA__CFG14, CYREG_UDB_PA0_CFG14
.set cap2__0__PA__CFG2, CYREG_UDB_PA0_CFG2
.set cap2__0__PA__CFG3, CYREG_UDB_PA0_CFG3
.set cap2__0__PA__CFG4, CYREG_UDB_PA0_CFG4
.set cap2__0__PA__CFG5, CYREG_UDB_PA0_CFG5
.set cap2__0__PA__CFG6, CYREG_UDB_PA0_CFG6
.set cap2__0__PA__CFG7, CYREG_UDB_PA0_CFG7
.set cap2__0__PA__CFG8, CYREG_UDB_PA0_CFG8
.set cap2__0__PA__CFG9, CYREG_UDB_PA0_CFG9
.set cap2__0__PC, CYREG_PRT0_PC
.set cap2__0__PC2, CYREG_PRT0_PC2
.set cap2__0__PORT, 0
.set cap2__0__PS, CYREG_PRT0_PS
.set cap2__0__SHIFT, 4
.set cap2__DR, CYREG_PRT0_DR
.set cap2__INTCFG, CYREG_PRT0_INTCFG
.set cap2__INTSTAT, CYREG_PRT0_INTSTAT
.set cap2__MASK, 0x10
.set cap2__PA__CFG0, CYREG_UDB_PA0_CFG0
.set cap2__PA__CFG1, CYREG_UDB_PA0_CFG1
.set cap2__PA__CFG10, CYREG_UDB_PA0_CFG10
.set cap2__PA__CFG11, CYREG_UDB_PA0_CFG11
.set cap2__PA__CFG12, CYREG_UDB_PA0_CFG12
.set cap2__PA__CFG13, CYREG_UDB_PA0_CFG13
.set cap2__PA__CFG14, CYREG_UDB_PA0_CFG14
.set cap2__PA__CFG2, CYREG_UDB_PA0_CFG2
.set cap2__PA__CFG3, CYREG_UDB_PA0_CFG3
.set cap2__PA__CFG4, CYREG_UDB_PA0_CFG4
.set cap2__PA__CFG5, CYREG_UDB_PA0_CFG5
.set cap2__PA__CFG6, CYREG_UDB_PA0_CFG6
.set cap2__PA__CFG7, CYREG_UDB_PA0_CFG7
.set cap2__PA__CFG8, CYREG_UDB_PA0_CFG8
.set cap2__PA__CFG9, CYREG_UDB_PA0_CFG9
.set cap2__PC, CYREG_PRT0_PC
.set cap2__PC2, CYREG_PRT0_PC2
.set cap2__PORT, 0
.set cap2__PS, CYREG_PRT0_PS
.set cap2__SHIFT, 4

/* hall */
.set hall__0__DM__MASK, 0x38
.set hall__0__DM__SHIFT, 3
.set hall__0__DR, CYREG_PRT0_DR
.set hall__0__HSIOM, CYREG_HSIOM_PORT_SEL0
.set hall__0__HSIOM_MASK, 0x000000F0
.set hall__0__HSIOM_SHIFT, 4
.set hall__0__INTCFG, CYREG_PRT0_INTCFG
.set hall__0__INTSTAT, CYREG_PRT0_INTSTAT
.set hall__0__MASK, 0x02
.set hall__0__OUT_SEL, CYREG_UDB_PA0_CFG10
.set hall__0__OUT_SEL_SHIFT, 2
.set hall__0__OUT_SEL_VAL, 2
.set hall__0__PA__CFG0, CYREG_UDB_PA0_CFG0
.set hall__0__PA__CFG1, CYREG_UDB_PA0_CFG1
.set hall__0__PA__CFG10, CYREG_UDB_PA0_CFG10
.set hall__0__PA__CFG11, CYREG_UDB_PA0_CFG11
.set hall__0__PA__CFG12, CYREG_UDB_PA0_CFG12
.set hall__0__PA__CFG13, CYREG_UDB_PA0_CFG13
.set hall__0__PA__CFG14, CYREG_UDB_PA0_CFG14
.set hall__0__PA__CFG2, CYREG_UDB_PA0_CFG2
.set hall__0__PA__CFG3, CYREG_UDB_PA0_CFG3
.set hall__0__PA__CFG4, CYREG_UDB_PA0_CFG4
.set hall__0__PA__CFG5, CYREG_UDB_PA0_CFG5
.set hall__0__PA__CFG6, CYREG_UDB_PA0_CFG6
.set hall__0__PA__CFG7, CYREG_UDB_PA0_CFG7
.set hall__0__PA__CFG8, CYREG_UDB_PA0_CFG8
.set hall__0__PA__CFG9, CYREG_UDB_PA0_CFG9
.set hall__0__PC, CYREG_PRT0_PC
.set hall__0__PC2, CYREG_PRT0_PC2
.set hall__0__PORT, 0
.set hall__0__PS, CYREG_PRT0_PS
.set hall__0__SHIFT, 1
.set hall__DR, CYREG_PRT0_DR
.set hall__INTCFG, CYREG_PRT0_INTCFG
.set hall__INTSTAT, CYREG_PRT0_INTSTAT
.set hall__MASK, 0x02
.set hall__PA__CFG0, CYREG_UDB_PA0_CFG0
.set hall__PA__CFG1, CYREG_UDB_PA0_CFG1
.set hall__PA__CFG10, CYREG_UDB_PA0_CFG10
.set hall__PA__CFG11, CYREG_UDB_PA0_CFG11
.set hall__PA__CFG12, CYREG_UDB_PA0_CFG12
.set hall__PA__CFG13, CYREG_UDB_PA0_CFG13
.set hall__PA__CFG14, CYREG_UDB_PA0_CFG14
.set hall__PA__CFG2, CYREG_UDB_PA0_CFG2
.set hall__PA__CFG3, CYREG_UDB_PA0_CFG3
.set hall__PA__CFG4, CYREG_UDB_PA0_CFG4
.set hall__PA__CFG5, CYREG_UDB_PA0_CFG5
.set hall__PA__CFG6, CYREG_UDB_PA0_CFG6
.set hall__PA__CFG7, CYREG_UDB_PA0_CFG7
.set hall__PA__CFG8, CYREG_UDB_PA0_CFG8
.set hall__PA__CFG9, CYREG_UDB_PA0_CFG9
.set hall__PC, CYREG_PRT0_PC
.set hall__PC2, CYREG_PRT0_PC2
.set hall__PORT, 0
.set hall__PS, CYREG_PRT0_PS
.set hall__SHIFT, 1

/* Clock */
.set Clock__DIVIDER_MASK, 0x0000FFFF
.set Clock__ENABLE, CYREG_CLK_DIVIDER_B00
.set Clock__ENABLE_MASK, 0x80000000
.set Clock__MASK, 0x80000000
.set Clock__REGISTER, CYREG_CLK_DIVIDER_B00

/* nSLEEP */
.set nSLEEP__0__DM__MASK, 0x1C0
.set nSLEEP__0__DM__SHIFT, 6
.set nSLEEP__0__DR, CYREG_PRT0_DR
.set nSLEEP__0__HSIOM, CYREG_HSIOM_PORT_SEL0
.set nSLEEP__0__HSIOM_MASK, 0x00000F00
.set nSLEEP__0__HSIOM_SHIFT, 8
.set nSLEEP__0__INTCFG, CYREG_PRT0_INTCFG
.set nSLEEP__0__INTSTAT, CYREG_PRT0_INTSTAT
.set nSLEEP__0__MASK, 0x04
.set nSLEEP__0__OUT_SEL, CYREG_UDB_PA0_CFG10
.set nSLEEP__0__OUT_SEL_SHIFT, 4
.set nSLEEP__0__OUT_SEL_VAL, 0
.set nSLEEP__0__PA__CFG0, CYREG_UDB_PA0_CFG0
.set nSLEEP__0__PA__CFG1, CYREG_UDB_PA0_CFG1
.set nSLEEP__0__PA__CFG10, CYREG_UDB_PA0_CFG10
.set nSLEEP__0__PA__CFG11, CYREG_UDB_PA0_CFG11
.set nSLEEP__0__PA__CFG12, CYREG_UDB_PA0_CFG12
.set nSLEEP__0__PA__CFG13, CYREG_UDB_PA0_CFG13
.set nSLEEP__0__PA__CFG14, CYREG_UDB_PA0_CFG14
.set nSLEEP__0__PA__CFG2, CYREG_UDB_PA0_CFG2
.set nSLEEP__0__PA__CFG3, CYREG_UDB_PA0_CFG3
.set nSLEEP__0__PA__CFG4, CYREG_UDB_PA0_CFG4
.set nSLEEP__0__PA__CFG5, CYREG_UDB_PA0_CFG5
.set nSLEEP__0__PA__CFG6, CYREG_UDB_PA0_CFG6
.set nSLEEP__0__PA__CFG7, CYREG_UDB_PA0_CFG7
.set nSLEEP__0__PA__CFG8, CYREG_UDB_PA0_CFG8
.set nSLEEP__0__PA__CFG9, CYREG_UDB_PA0_CFG9
.set nSLEEP__0__PC, CYREG_PRT0_PC
.set nSLEEP__0__PC2, CYREG_PRT0_PC2
.set nSLEEP__0__PORT, 0
.set nSLEEP__0__PS, CYREG_PRT0_PS
.set nSLEEP__0__SHIFT, 2
.set nSLEEP__DR, CYREG_PRT0_DR
.set nSLEEP__INTCFG, CYREG_PRT0_INTCFG
.set nSLEEP__INTSTAT, CYREG_PRT0_INTSTAT
.set nSLEEP__MASK, 0x04
.set nSLEEP__PA__CFG0, CYREG_UDB_PA0_CFG0
.set nSLEEP__PA__CFG1, CYREG_UDB_PA0_CFG1
.set nSLEEP__PA__CFG10, CYREG_UDB_PA0_CFG10
.set nSLEEP__PA__CFG11, CYREG_UDB_PA0_CFG11
.set nSLEEP__PA__CFG12, CYREG_UDB_PA0_CFG12
.set nSLEEP__PA__CFG13, CYREG_UDB_PA0_CFG13
.set nSLEEP__PA__CFG14, CYREG_UDB_PA0_CFG14
.set nSLEEP__PA__CFG2, CYREG_UDB_PA0_CFG2
.set nSLEEP__PA__CFG3, CYREG_UDB_PA0_CFG3
.set nSLEEP__PA__CFG4, CYREG_UDB_PA0_CFG4
.set nSLEEP__PA__CFG5, CYREG_UDB_PA0_CFG5
.set nSLEEP__PA__CFG6, CYREG_UDB_PA0_CFG6
.set nSLEEP__PA__CFG7, CYREG_UDB_PA0_CFG7
.set nSLEEP__PA__CFG8, CYREG_UDB_PA0_CFG8
.set nSLEEP__PA__CFG9, CYREG_UDB_PA0_CFG9
.set nSLEEP__PC, CYREG_PRT0_PC
.set nSLEEP__PC2, CYREG_PRT0_PC2
.set nSLEEP__PORT, 0
.set nSLEEP__PS, CYREG_PRT0_PS
.set nSLEEP__SHIFT, 2

/* Counter_1_CounterUDB */
.set Counter_1_CounterUDB_sC16_counterdp_u0__16BIT_A0_REG, CYREG_UDB_W16_A0_00
.set Counter_1_CounterUDB_sC16_counterdp_u0__16BIT_A1_REG, CYREG_UDB_W16_A1_00
.set Counter_1_CounterUDB_sC16_counterdp_u0__16BIT_D0_REG, CYREG_UDB_W16_D0_00
.set Counter_1_CounterUDB_sC16_counterdp_u0__16BIT_D1_REG, CYREG_UDB_W16_D1_00
.set Counter_1_CounterUDB_sC16_counterdp_u0__16BIT_DP_AUX_CTL_REG, CYREG_UDB_W16_ACTL_00
.set Counter_1_CounterUDB_sC16_counterdp_u0__16BIT_F0_REG, CYREG_UDB_W16_F0_00
.set Counter_1_CounterUDB_sC16_counterdp_u0__16BIT_F1_REG, CYREG_UDB_W16_F1_00
.set Counter_1_CounterUDB_sC16_counterdp_u0__32BIT_A0_REG, CYREG_UDB_W32_A0_00
.set Counter_1_CounterUDB_sC16_counterdp_u0__32BIT_A1_REG, CYREG_UDB_W32_A1_00
.set Counter_1_CounterUDB_sC16_counterdp_u0__32BIT_D0_REG, CYREG_UDB_W32_D0_00
.set Counter_1_CounterUDB_sC16_counterdp_u0__32BIT_D1_REG, CYREG_UDB_W32_D1_00
.set Counter_1_CounterUDB_sC16_counterdp_u0__32BIT_DP_AUX_CTL_REG, CYREG_UDB_W32_ACTL_00
.set Counter_1_CounterUDB_sC16_counterdp_u0__32BIT_F0_REG, CYREG_UDB_W32_F0_00
.set Counter_1_CounterUDB_sC16_counterdp_u0__32BIT_F1_REG, CYREG_UDB_W32_F1_00
.set Counter_1_CounterUDB_sC16_counterdp_u0__A0_A1_REG, CYREG_UDB_CAT16_A_00
.set Counter_1_CounterUDB_sC16_counterdp_u0__A0_REG, CYREG_UDB_W8_A0_00
.set Counter_1_CounterUDB_sC16_counterdp_u0__A1_REG, CYREG_UDB_W8_A1_00
.set Counter_1_CounterUDB_sC16_counterdp_u0__D0_D1_REG, CYREG_UDB_CAT16_D_00
.set Counter_1_CounterUDB_sC16_counterdp_u0__D0_REG, CYREG_UDB_W8_D0_00
.set Counter_1_CounterUDB_sC16_counterdp_u0__D1_REG, CYREG_UDB_W8_D1_00
.set Counter_1_CounterUDB_sC16_counterdp_u0__DP_AUX_CTL_REG, CYREG_UDB_W8_ACTL_00
.set Counter_1_CounterUDB_sC16_counterdp_u0__F0_F1_REG, CYREG_UDB_CAT16_F_00
.set Counter_1_CounterUDB_sC16_counterdp_u0__F0_REG, CYREG_UDB_W8_F0_00
.set Counter_1_CounterUDB_sC16_counterdp_u0__F1_REG, CYREG_UDB_W8_F1_00
.set Counter_1_CounterUDB_sC16_counterdp_u1__16BIT_A0_REG, CYREG_UDB_W16_A0_01
.set Counter_1_CounterUDB_sC16_counterdp_u1__16BIT_A1_REG, CYREG_UDB_W16_A1_01
.set Counter_1_CounterUDB_sC16_counterdp_u1__16BIT_D0_REG, CYREG_UDB_W16_D0_01
.set Counter_1_CounterUDB_sC16_counterdp_u1__16BIT_D1_REG, CYREG_UDB_W16_D1_01
.set Counter_1_CounterUDB_sC16_counterdp_u1__16BIT_DP_AUX_CTL_REG, CYREG_UDB_W16_ACTL_01
.set Counter_1_CounterUDB_sC16_counterdp_u1__16BIT_F0_REG, CYREG_UDB_W16_F0_01
.set Counter_1_CounterUDB_sC16_counterdp_u1__16BIT_F1_REG, CYREG_UDB_W16_F1_01
.set Counter_1_CounterUDB_sC16_counterdp_u1__A0_A1_REG, CYREG_UDB_CAT16_A_01
.set Counter_1_CounterUDB_sC16_counterdp_u1__A0_REG, CYREG_UDB_W8_A0_01
.set Counter_1_CounterUDB_sC16_counterdp_u1__A1_REG, CYREG_UDB_W8_A1_01
.set Counter_1_CounterUDB_sC16_counterdp_u1__D0_D1_REG, CYREG_UDB_CAT16_D_01
.set Counter_1_CounterUDB_sC16_counterdp_u1__D0_REG, CYREG_UDB_W8_D0_01
.set Counter_1_CounterUDB_sC16_counterdp_u1__D1_REG, CYREG_UDB_W8_D1_01
.set Counter_1_CounterUDB_sC16_counterdp_u1__DP_AUX_CTL_REG, CYREG_UDB_W8_ACTL_01
.set Counter_1_CounterUDB_sC16_counterdp_u1__F0_F1_REG, CYREG_UDB_CAT16_F_01
.set Counter_1_CounterUDB_sC16_counterdp_u1__F0_REG, CYREG_UDB_W8_F0_01
.set Counter_1_CounterUDB_sC16_counterdp_u1__F1_REG, CYREG_UDB_W8_F1_01
.set Counter_1_CounterUDB_sC16_counterdp_u1__MSK_DP_AUX_CTL_REG, CYREG_UDB_CAT16_ACTL_MSK_01
.set Counter_1_CounterUDB_sC16_counterdp_u1__PER_DP_AUX_CTL_REG, CYREG_UDB_CAT16_ACTL_MSK_01
.set Counter_1_CounterUDB_sSTSReg_rstSts_stsreg__0__MASK, 0x01
.set Counter_1_CounterUDB_sSTSReg_rstSts_stsreg__0__POS, 0
.set Counter_1_CounterUDB_sSTSReg_rstSts_stsreg__1__MASK, 0x02
.set Counter_1_CounterUDB_sSTSReg_rstSts_stsreg__1__POS, 1
.set Counter_1_CounterUDB_sSTSReg_rstSts_stsreg__16BIT_STATUS_AUX_CTL_REG, CYREG_UDB_W16_ACTL_01
.set Counter_1_CounterUDB_sSTSReg_rstSts_stsreg__16BIT_STATUS_REG, CYREG_UDB_W16_ST_01
.set Counter_1_CounterUDB_sSTSReg_rstSts_stsreg__2__MASK, 0x04
.set Counter_1_CounterUDB_sSTSReg_rstSts_stsreg__2__POS, 2
.set Counter_1_CounterUDB_sSTSReg_rstSts_stsreg__5__MASK, 0x20
.set Counter_1_CounterUDB_sSTSReg_rstSts_stsreg__5__POS, 5
.set Counter_1_CounterUDB_sSTSReg_rstSts_stsreg__6__MASK, 0x40
.set Counter_1_CounterUDB_sSTSReg_rstSts_stsreg__6__POS, 6
.set Counter_1_CounterUDB_sSTSReg_rstSts_stsreg__MASK, 0x67
.set Counter_1_CounterUDB_sSTSReg_rstSts_stsreg__MASK_REG, CYREG_UDB_W8_MSK_01
.set Counter_1_CounterUDB_sSTSReg_rstSts_stsreg__MASK_ST_AUX_CTL_REG, CYREG_UDB_CAT16_ACTL_MSK_01
.set Counter_1_CounterUDB_sSTSReg_rstSts_stsreg__PER_ST_AUX_CTL_REG, CYREG_UDB_CAT16_ACTL_MSK_01
.set Counter_1_CounterUDB_sSTSReg_rstSts_stsreg__STATUS_AUX_CTL_REG, CYREG_UDB_W8_ACTL_01
.set Counter_1_CounterUDB_sSTSReg_rstSts_stsreg__STATUS_CNT_REG, CYREG_UDB_CAT16_CTL_ST_01
.set Counter_1_CounterUDB_sSTSReg_rstSts_stsreg__STATUS_CONTROL_REG, CYREG_UDB_CAT16_CTL_ST_01
.set Counter_1_CounterUDB_sSTSReg_rstSts_stsreg__STATUS_REG, CYREG_UDB_W8_ST_01

/* Control_Reg */
.set Control_Reg_Sync_ctrl_reg__0__MASK, 0x01
.set Control_Reg_Sync_ctrl_reg__0__POS, 0
.set Control_Reg_Sync_ctrl_reg__1__MASK, 0x02
.set Control_Reg_Sync_ctrl_reg__1__POS, 1
.set Control_Reg_Sync_ctrl_reg__16BIT_CONTROL_AUX_CTL_REG, CYREG_UDB_W16_ACTL_01
.set Control_Reg_Sync_ctrl_reg__16BIT_CONTROL_CONTROL_REG, CYREG_UDB_W16_CTL_01
.set Control_Reg_Sync_ctrl_reg__16BIT_CONTROL_COUNT_REG, CYREG_UDB_W16_CTL_01
.set Control_Reg_Sync_ctrl_reg__16BIT_COUNT_CONTROL_REG, CYREG_UDB_W16_CTL_01
.set Control_Reg_Sync_ctrl_reg__16BIT_COUNT_COUNT_REG, CYREG_UDB_W16_CTL_01
.set Control_Reg_Sync_ctrl_reg__16BIT_MASK_MASK_REG, CYREG_UDB_W16_MSK_01
.set Control_Reg_Sync_ctrl_reg__16BIT_MASK_PERIOD_REG, CYREG_UDB_W16_MSK_01
.set Control_Reg_Sync_ctrl_reg__16BIT_PERIOD_MASK_REG, CYREG_UDB_W16_MSK_01
.set Control_Reg_Sync_ctrl_reg__16BIT_PERIOD_PERIOD_REG, CYREG_UDB_W16_MSK_01
.set Control_Reg_Sync_ctrl_reg__CONTROL_AUX_CTL_REG, CYREG_UDB_W8_ACTL_01
.set Control_Reg_Sync_ctrl_reg__CONTROL_REG, CYREG_UDB_W8_CTL_01
.set Control_Reg_Sync_ctrl_reg__CONTROL_ST_REG, CYREG_UDB_CAT16_CTL_ST_01
.set Control_Reg_Sync_ctrl_reg__COUNT_REG, CYREG_UDB_W8_CTL_01
.set Control_Reg_Sync_ctrl_reg__COUNT_ST_REG, CYREG_UDB_CAT16_CTL_ST_01
.set Control_Reg_Sync_ctrl_reg__MASK, 0x03
.set Control_Reg_Sync_ctrl_reg__MASK_CTL_AUX_CTL_REG, CYREG_UDB_CAT16_ACTL_MSK_01
.set Control_Reg_Sync_ctrl_reg__PER_CTL_AUX_CTL_REG, CYREG_UDB_CAT16_ACTL_MSK_01
.set Control_Reg_Sync_ctrl_reg__PERIOD_REG, CYREG_UDB_W8_MSK_01

/* Miscellaneous */
.set CYDEV_BCLK__HFCLK__HZ, 24000000
.set CYDEV_BCLK__HFCLK__KHZ, 24000
.set CYDEV_BCLK__HFCLK__MHZ, 24
.set CYDEV_BCLK__SYSCLK__HZ, 24000000
.set CYDEV_BCLK__SYSCLK__KHZ, 24000
.set CYDEV_BCLK__SYSCLK__MHZ, 24
.set CYDEV_CHIP_DIE_LEOPARD, 1
.set CYDEV_CHIP_DIE_PANTHER, 4
.set CYDEV_CHIP_DIE_PSOC4A, 2
.set CYDEV_CHIP_DIE_PSOC5LP, 5
.set CYDEV_CHIP_DIE_UNKNOWN, 0
.set CYDEV_CHIP_FAMILY_PSOC3, 1
.set CYDEV_CHIP_FAMILY_PSOC4, 2
.set CYDEV_CHIP_FAMILY_PSOC5, 3
.set CYDEV_CHIP_FAMILY_UNKNOWN, 0
.set CYDEV_CHIP_FAMILY_USED, CYDEV_CHIP_FAMILY_PSOC4
.set CYDEV_CHIP_JTAG_ID, 0x04C81193
.set CYDEV_CHIP_MEMBER_3A, 1
.set CYDEV_CHIP_MEMBER_4A, 2
.set CYDEV_CHIP_MEMBER_4D, 3
.set CYDEV_CHIP_MEMBER_5A, 4
.set CYDEV_CHIP_MEMBER_5B, 5
.set CYDEV_CHIP_MEMBER_UNKNOWN, 0
.set CYDEV_CHIP_MEMBER_USED, CYDEV_CHIP_MEMBER_4A
.set CYDEV_CHIP_DIE_EXPECT, CYDEV_CHIP_MEMBER_USED
.set CYDEV_CHIP_DIE_ACTUAL, CYDEV_CHIP_DIE_EXPECT
.set CYDEV_CHIP_REV_LEOPARD_ES1, 0
.set CYDEV_CHIP_REV_LEOPARD_ES2, 1
.set CYDEV_CHIP_REV_LEOPARD_ES3, 3
.set CYDEV_CHIP_REV_LEOPARD_PRODUCTION, 3
.set CYDEV_CHIP_REV_PANTHER_ES0, 0
.set CYDEV_CHIP_REV_PANTHER_ES1, 1
.set CYDEV_CHIP_REV_PANTHER_PRODUCTION, 1
.set CYDEV_CHIP_REV_PSOC4A_ES0, 17
.set CYDEV_CHIP_REV_PSOC4A_PRODUCTION, 17
.set CYDEV_CHIP_REV_PSOC5LP_ES0, 0
.set CYDEV_CHIP_REV_PSOC5LP_PRODUCTION, 0
.set CYDEV_CHIP_REVISION_3A_ES1, 0
.set CYDEV_CHIP_REVISION_3A_ES2, 1
.set CYDEV_CHIP_REVISION_3A_ES3, 3
.set CYDEV_CHIP_REVISION_3A_PRODUCTION, 3
.set CYDEV_CHIP_REVISION_4A_ES0, 17
.set CYDEV_CHIP_REVISION_4A_PRODUCTION, 17
.set CYDEV_CHIP_REVISION_4D_ES0, 0
.set CYDEV_CHIP_REVISION_4D_PRODUCTION, 0
.set CYDEV_CHIP_REVISION_5A_ES0, 0
.set CYDEV_CHIP_REVISION_5A_ES1, 1
.set CYDEV_CHIP_REVISION_5A_PRODUCTION, 1
.set CYDEV_CHIP_REVISION_5B_ES0, 0
.set CYDEV_CHIP_REVISION_5B_PRODUCTION, 0
.set CYDEV_CHIP_REVISION_USED, CYDEV_CHIP_REVISION_4A_PRODUCTION
.set CYDEV_CHIP_REV_EXPECT, CYDEV_CHIP_REVISION_USED
.set CYDEV_CONFIG_READ_ACCELERATOR, 1
.set CYDEV_CONFIG_UNUSED_IO_AllowButWarn, 0
.set CYDEV_CONFIG_UNUSED_IO, CYDEV_CONFIG_UNUSED_IO_AllowButWarn
.set CYDEV_CONFIG_UNUSED_IO_AllowWithInfo, 1
.set CYDEV_CONFIG_UNUSED_IO_Disallowed, 2
.set CYDEV_CONFIGURATION_COMPRESSED, 1
.set CYDEV_CONFIGURATION_MODE_COMPRESSED, 0
.set CYDEV_CONFIGURATION_MODE, CYDEV_CONFIGURATION_MODE_COMPRESSED
.set CYDEV_CONFIGURATION_MODE_DMA, 2
.set CYDEV_CONFIGURATION_MODE_UNCOMPRESSED, 1
.set CYDEV_DEBUG_PROTECT_KILL, 4
.set CYDEV_DEBUG_PROTECT_OPEN, 1
.set CYDEV_DEBUG_PROTECT, CYDEV_DEBUG_PROTECT_OPEN
.set CYDEV_DEBUG_PROTECT_PROTECTED, 2
.set CYDEV_DEBUGGING_DPS_Disable, 3
.set CYDEV_DEBUGGING_DPS_SWD, 2
.set CYDEV_DEBUGGING_DPS, CYDEV_DEBUGGING_DPS_SWD
.set CYDEV_DEBUGGING_ENABLE, 1
.set CYDEV_HEAP_SIZE, 0x0100
.set CYDEV_PROJ_TYPE, 0
.set CYDEV_PROJ_TYPE_BOOTLOADER, 1
.set CYDEV_PROJ_TYPE_LOADABLE, 2
.set CYDEV_PROJ_TYPE_MULTIAPPBOOTLOADER, 3
.set CYDEV_PROJ_TYPE_STANDARD, 0
.set CYDEV_STACK_SIZE, 0x0400
.set CYDEV_USE_BUNDLED_CMSIS, 1
.set CYDEV_VARIABLE_VDDA, 1
.set CYDEV_VDDA_MV, 3300
.set CYDEV_VDDD_MV, 3300
.set CYIPBLOCK_M0S8_CTBM_VERSION, 0
.set CYIPBLOCK_m0s8cpuss_VERSION, 0
.set CYIPBLOCK_m0s8csd_VERSION, 0
.set CYIPBLOCK_m0s8gpio2_VERSION, 0
.set CYIPBLOCK_m0s8hsiom4a_VERSION, 0
.set CYIPBLOCK_m0s8lcd_VERSION, 0
.set CYIPBLOCK_m0s8lpcomp_VERSION, 0
.set CYIPBLOCK_m0s8pclk_VERSION, 0
.set CYIPBLOCK_m0s8sar_VERSION, 0
.set CYIPBLOCK_m0s8scb_VERSION, 0
.set CYIPBLOCK_m0s8srssv2_VERSION, 1
.set CYIPBLOCK_m0s8tcpwm_VERSION, 0
.set CYIPBLOCK_m0s8udbif_VERSION, 0
.set CYIPBLOCK_S8_GPIO_VERSION, 2
.set CYDEV_BOOTLOADER_ENABLE, 0
.endif
