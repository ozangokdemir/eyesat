    IF :LNOT::DEF:INCLUDED_CYFITTERRV_INC
INCLUDED_CYFITTERRV_INC EQU 1
    GET cydevicerv_trm.inc

; M0
M0__0__DM__MASK EQU 0x07
M0__0__DM__SHIFT EQU 0
M0__0__DR EQU CYREG_PRT0_DR
M0__0__HSIOM EQU CYREG_HSIOM_PORT_SEL0
M0__0__HSIOM_MASK EQU 0x0000000F
M0__0__HSIOM_SHIFT EQU 0
M0__0__INTCFG EQU CYREG_PRT0_INTCFG
M0__0__INTSTAT EQU CYREG_PRT0_INTSTAT
M0__0__MASK EQU 0x01
M0__0__OUT_SEL EQU CYREG_UDB_PA0_CFG10
M0__0__OUT_SEL_SHIFT EQU 0
M0__0__OUT_SEL_VAL EQU 3
M0__0__PA__CFG0 EQU CYREG_UDB_PA0_CFG0
M0__0__PA__CFG1 EQU CYREG_UDB_PA0_CFG1
M0__0__PA__CFG10 EQU CYREG_UDB_PA0_CFG10
M0__0__PA__CFG11 EQU CYREG_UDB_PA0_CFG11
M0__0__PA__CFG12 EQU CYREG_UDB_PA0_CFG12
M0__0__PA__CFG13 EQU CYREG_UDB_PA0_CFG13
M0__0__PA__CFG14 EQU CYREG_UDB_PA0_CFG14
M0__0__PA__CFG2 EQU CYREG_UDB_PA0_CFG2
M0__0__PA__CFG3 EQU CYREG_UDB_PA0_CFG3
M0__0__PA__CFG4 EQU CYREG_UDB_PA0_CFG4
M0__0__PA__CFG5 EQU CYREG_UDB_PA0_CFG5
M0__0__PA__CFG6 EQU CYREG_UDB_PA0_CFG6
M0__0__PA__CFG7 EQU CYREG_UDB_PA0_CFG7
M0__0__PA__CFG8 EQU CYREG_UDB_PA0_CFG8
M0__0__PA__CFG9 EQU CYREG_UDB_PA0_CFG9
M0__0__PC EQU CYREG_PRT0_PC
M0__0__PC2 EQU CYREG_PRT0_PC2
M0__0__PORT EQU 0
M0__0__PS EQU CYREG_PRT0_PS
M0__0__SHIFT EQU 0
M0__DR EQU CYREG_PRT0_DR
M0__INTCFG EQU CYREG_PRT0_INTCFG
M0__INTSTAT EQU CYREG_PRT0_INTSTAT
M0__MASK EQU 0x01
M0__PA__CFG0 EQU CYREG_UDB_PA0_CFG0
M0__PA__CFG1 EQU CYREG_UDB_PA0_CFG1
M0__PA__CFG10 EQU CYREG_UDB_PA0_CFG10
M0__PA__CFG11 EQU CYREG_UDB_PA0_CFG11
M0__PA__CFG12 EQU CYREG_UDB_PA0_CFG12
M0__PA__CFG13 EQU CYREG_UDB_PA0_CFG13
M0__PA__CFG14 EQU CYREG_UDB_PA0_CFG14
M0__PA__CFG2 EQU CYREG_UDB_PA0_CFG2
M0__PA__CFG3 EQU CYREG_UDB_PA0_CFG3
M0__PA__CFG4 EQU CYREG_UDB_PA0_CFG4
M0__PA__CFG5 EQU CYREG_UDB_PA0_CFG5
M0__PA__CFG6 EQU CYREG_UDB_PA0_CFG6
M0__PA__CFG7 EQU CYREG_UDB_PA0_CFG7
M0__PA__CFG8 EQU CYREG_UDB_PA0_CFG8
M0__PA__CFG9 EQU CYREG_UDB_PA0_CFG9
M0__PC EQU CYREG_PRT0_PC
M0__PC2 EQU CYREG_PRT0_PC2
M0__PORT EQU 0
M0__PS EQU CYREG_PRT0_PS
M0__SHIFT EQU 0

; M1
M1__0__DM__MASK EQU 0x07
M1__0__DM__SHIFT EQU 0
M1__0__DR EQU CYREG_PRT1_DR
M1__0__HSIOM EQU CYREG_HSIOM_PORT_SEL1
M1__0__HSIOM_MASK EQU 0x0000000F
M1__0__HSIOM_SHIFT EQU 0
M1__0__INTCFG EQU CYREG_PRT1_INTCFG
M1__0__INTSTAT EQU CYREG_PRT1_INTSTAT
M1__0__MASK EQU 0x01
M1__0__OUT_SEL EQU CYREG_UDB_PA1_CFG10
M1__0__OUT_SEL_SHIFT EQU 0
M1__0__OUT_SEL_VAL EQU 3
M1__0__PA__CFG0 EQU CYREG_UDB_PA1_CFG0
M1__0__PA__CFG1 EQU CYREG_UDB_PA1_CFG1
M1__0__PA__CFG10 EQU CYREG_UDB_PA1_CFG10
M1__0__PA__CFG11 EQU CYREG_UDB_PA1_CFG11
M1__0__PA__CFG12 EQU CYREG_UDB_PA1_CFG12
M1__0__PA__CFG13 EQU CYREG_UDB_PA1_CFG13
M1__0__PA__CFG14 EQU CYREG_UDB_PA1_CFG14
M1__0__PA__CFG2 EQU CYREG_UDB_PA1_CFG2
M1__0__PA__CFG3 EQU CYREG_UDB_PA1_CFG3
M1__0__PA__CFG4 EQU CYREG_UDB_PA1_CFG4
M1__0__PA__CFG5 EQU CYREG_UDB_PA1_CFG5
M1__0__PA__CFG6 EQU CYREG_UDB_PA1_CFG6
M1__0__PA__CFG7 EQU CYREG_UDB_PA1_CFG7
M1__0__PA__CFG8 EQU CYREG_UDB_PA1_CFG8
M1__0__PA__CFG9 EQU CYREG_UDB_PA1_CFG9
M1__0__PC EQU CYREG_PRT1_PC
M1__0__PC2 EQU CYREG_PRT1_PC2
M1__0__PORT EQU 1
M1__0__PS EQU CYREG_PRT1_PS
M1__0__SHIFT EQU 0
M1__DR EQU CYREG_PRT1_DR
M1__INTCFG EQU CYREG_PRT1_INTCFG
M1__INTSTAT EQU CYREG_PRT1_INTSTAT
M1__MASK EQU 0x01
M1__PA__CFG0 EQU CYREG_UDB_PA1_CFG0
M1__PA__CFG1 EQU CYREG_UDB_PA1_CFG1
M1__PA__CFG10 EQU CYREG_UDB_PA1_CFG10
M1__PA__CFG11 EQU CYREG_UDB_PA1_CFG11
M1__PA__CFG12 EQU CYREG_UDB_PA1_CFG12
M1__PA__CFG13 EQU CYREG_UDB_PA1_CFG13
M1__PA__CFG14 EQU CYREG_UDB_PA1_CFG14
M1__PA__CFG2 EQU CYREG_UDB_PA1_CFG2
M1__PA__CFG3 EQU CYREG_UDB_PA1_CFG3
M1__PA__CFG4 EQU CYREG_UDB_PA1_CFG4
M1__PA__CFG5 EQU CYREG_UDB_PA1_CFG5
M1__PA__CFG6 EQU CYREG_UDB_PA1_CFG6
M1__PA__CFG7 EQU CYREG_UDB_PA1_CFG7
M1__PA__CFG8 EQU CYREG_UDB_PA1_CFG8
M1__PA__CFG9 EQU CYREG_UDB_PA1_CFG9
M1__PC EQU CYREG_PRT1_PC
M1__PC2 EQU CYREG_PRT1_PC2
M1__PORT EQU 1
M1__PS EQU CYREG_PRT1_PS
M1__SHIFT EQU 0

; DIR
DIR__0__DM__MASK EQU 0xE00
DIR__0__DM__SHIFT EQU 9
DIR__0__DR EQU CYREG_PRT0_DR
DIR__0__HSIOM EQU CYREG_HSIOM_PORT_SEL0
DIR__0__HSIOM_MASK EQU 0x0000F000
DIR__0__HSIOM_SHIFT EQU 12
DIR__0__INTCFG EQU CYREG_PRT0_INTCFG
DIR__0__INTSTAT EQU CYREG_PRT0_INTSTAT
DIR__0__MASK EQU 0x08
DIR__0__OUT_SEL EQU CYREG_UDB_PA0_CFG10
DIR__0__OUT_SEL_SHIFT EQU 6
DIR__0__OUT_SEL_VAL EQU 1
DIR__0__PA__CFG0 EQU CYREG_UDB_PA0_CFG0
DIR__0__PA__CFG1 EQU CYREG_UDB_PA0_CFG1
DIR__0__PA__CFG10 EQU CYREG_UDB_PA0_CFG10
DIR__0__PA__CFG11 EQU CYREG_UDB_PA0_CFG11
DIR__0__PA__CFG12 EQU CYREG_UDB_PA0_CFG12
DIR__0__PA__CFG13 EQU CYREG_UDB_PA0_CFG13
DIR__0__PA__CFG14 EQU CYREG_UDB_PA0_CFG14
DIR__0__PA__CFG2 EQU CYREG_UDB_PA0_CFG2
DIR__0__PA__CFG3 EQU CYREG_UDB_PA0_CFG3
DIR__0__PA__CFG4 EQU CYREG_UDB_PA0_CFG4
DIR__0__PA__CFG5 EQU CYREG_UDB_PA0_CFG5
DIR__0__PA__CFG6 EQU CYREG_UDB_PA0_CFG6
DIR__0__PA__CFG7 EQU CYREG_UDB_PA0_CFG7
DIR__0__PA__CFG8 EQU CYREG_UDB_PA0_CFG8
DIR__0__PA__CFG9 EQU CYREG_UDB_PA0_CFG9
DIR__0__PC EQU CYREG_PRT0_PC
DIR__0__PC2 EQU CYREG_PRT0_PC2
DIR__0__PORT EQU 0
DIR__0__PS EQU CYREG_PRT0_PS
DIR__0__SHIFT EQU 3
DIR__DR EQU CYREG_PRT0_DR
DIR__INTCFG EQU CYREG_PRT0_INTCFG
DIR__INTSTAT EQU CYREG_PRT0_INTSTAT
DIR__MASK EQU 0x08
DIR__PA__CFG0 EQU CYREG_UDB_PA0_CFG0
DIR__PA__CFG1 EQU CYREG_UDB_PA0_CFG1
DIR__PA__CFG10 EQU CYREG_UDB_PA0_CFG10
DIR__PA__CFG11 EQU CYREG_UDB_PA0_CFG11
DIR__PA__CFG12 EQU CYREG_UDB_PA0_CFG12
DIR__PA__CFG13 EQU CYREG_UDB_PA0_CFG13
DIR__PA__CFG14 EQU CYREG_UDB_PA0_CFG14
DIR__PA__CFG2 EQU CYREG_UDB_PA0_CFG2
DIR__PA__CFG3 EQU CYREG_UDB_PA0_CFG3
DIR__PA__CFG4 EQU CYREG_UDB_PA0_CFG4
DIR__PA__CFG5 EQU CYREG_UDB_PA0_CFG5
DIR__PA__CFG6 EQU CYREG_UDB_PA0_CFG6
DIR__PA__CFG7 EQU CYREG_UDB_PA0_CFG7
DIR__PA__CFG8 EQU CYREG_UDB_PA0_CFG8
DIR__PA__CFG9 EQU CYREG_UDB_PA0_CFG9
DIR__PC EQU CYREG_PRT0_PC
DIR__PC2 EQU CYREG_PRT0_PC2
DIR__PORT EQU 0
DIR__PS EQU CYREG_PRT0_PS
DIR__SHIFT EQU 3

; PWM_PWMUDB
PWM_PWMUDB_genblk1_ctrlreg__16BIT_CONTROL_AUX_CTL_REG EQU CYREG_UDB_W16_ACTL_02
PWM_PWMUDB_genblk1_ctrlreg__16BIT_CONTROL_CONTROL_REG EQU CYREG_UDB_W16_CTL_02
PWM_PWMUDB_genblk1_ctrlreg__16BIT_CONTROL_COUNT_REG EQU CYREG_UDB_W16_CTL_02
PWM_PWMUDB_genblk1_ctrlreg__16BIT_COUNT_CONTROL_REG EQU CYREG_UDB_W16_CTL_02
PWM_PWMUDB_genblk1_ctrlreg__16BIT_COUNT_COUNT_REG EQU CYREG_UDB_W16_CTL_02
PWM_PWMUDB_genblk1_ctrlreg__16BIT_MASK_MASK_REG EQU CYREG_UDB_W16_MSK_02
PWM_PWMUDB_genblk1_ctrlreg__16BIT_MASK_PERIOD_REG EQU CYREG_UDB_W16_MSK_02
PWM_PWMUDB_genblk1_ctrlreg__16BIT_PERIOD_MASK_REG EQU CYREG_UDB_W16_MSK_02
PWM_PWMUDB_genblk1_ctrlreg__16BIT_PERIOD_PERIOD_REG EQU CYREG_UDB_W16_MSK_02
PWM_PWMUDB_genblk1_ctrlreg__7__MASK EQU 0x80
PWM_PWMUDB_genblk1_ctrlreg__7__POS EQU 7
PWM_PWMUDB_genblk1_ctrlreg__CONTROL_AUX_CTL_REG EQU CYREG_UDB_W8_ACTL_02
PWM_PWMUDB_genblk1_ctrlreg__CONTROL_REG EQU CYREG_UDB_W8_CTL_02
PWM_PWMUDB_genblk1_ctrlreg__CONTROL_ST_REG EQU CYREG_UDB_CAT16_CTL_ST_02
PWM_PWMUDB_genblk1_ctrlreg__COUNT_REG EQU CYREG_UDB_W8_CTL_02
PWM_PWMUDB_genblk1_ctrlreg__COUNT_ST_REG EQU CYREG_UDB_CAT16_CTL_ST_02
PWM_PWMUDB_genblk1_ctrlreg__MASK EQU 0x80
PWM_PWMUDB_genblk1_ctrlreg__MASK_CTL_AUX_CTL_REG EQU CYREG_UDB_CAT16_ACTL_MSK_02
PWM_PWMUDB_genblk1_ctrlreg__PER_CTL_AUX_CTL_REG EQU CYREG_UDB_CAT16_ACTL_MSK_02
PWM_PWMUDB_genblk1_ctrlreg__PERIOD_REG EQU CYREG_UDB_W8_MSK_02
PWM_PWMUDB_sP16_pwmdp_u0__16BIT_A0_REG EQU CYREG_UDB_W16_A0_02
PWM_PWMUDB_sP16_pwmdp_u0__16BIT_A1_REG EQU CYREG_UDB_W16_A1_02
PWM_PWMUDB_sP16_pwmdp_u0__16BIT_D0_REG EQU CYREG_UDB_W16_D0_02
PWM_PWMUDB_sP16_pwmdp_u0__16BIT_D1_REG EQU CYREG_UDB_W16_D1_02
PWM_PWMUDB_sP16_pwmdp_u0__16BIT_DP_AUX_CTL_REG EQU CYREG_UDB_W16_ACTL_02
PWM_PWMUDB_sP16_pwmdp_u0__16BIT_F0_REG EQU CYREG_UDB_W16_F0_02
PWM_PWMUDB_sP16_pwmdp_u0__16BIT_F1_REG EQU CYREG_UDB_W16_F1_02
PWM_PWMUDB_sP16_pwmdp_u0__A0_A1_REG EQU CYREG_UDB_CAT16_A_02
PWM_PWMUDB_sP16_pwmdp_u0__A0_REG EQU CYREG_UDB_W8_A0_02
PWM_PWMUDB_sP16_pwmdp_u0__A1_REG EQU CYREG_UDB_W8_A1_02
PWM_PWMUDB_sP16_pwmdp_u0__D0_D1_REG EQU CYREG_UDB_CAT16_D_02
PWM_PWMUDB_sP16_pwmdp_u0__D0_REG EQU CYREG_UDB_W8_D0_02
PWM_PWMUDB_sP16_pwmdp_u0__D1_REG EQU CYREG_UDB_W8_D1_02
PWM_PWMUDB_sP16_pwmdp_u0__DP_AUX_CTL_REG EQU CYREG_UDB_W8_ACTL_02
PWM_PWMUDB_sP16_pwmdp_u0__F0_F1_REG EQU CYREG_UDB_CAT16_F_02
PWM_PWMUDB_sP16_pwmdp_u0__F0_REG EQU CYREG_UDB_W8_F0_02
PWM_PWMUDB_sP16_pwmdp_u0__F1_REG EQU CYREG_UDB_W8_F1_02
PWM_PWMUDB_sP16_pwmdp_u0__MSK_DP_AUX_CTL_REG EQU CYREG_UDB_CAT16_ACTL_MSK_02
PWM_PWMUDB_sP16_pwmdp_u0__PER_DP_AUX_CTL_REG EQU CYREG_UDB_CAT16_ACTL_MSK_02
PWM_PWMUDB_sP16_pwmdp_u1__A0_A1_REG EQU CYREG_UDB_CAT16_A_03
PWM_PWMUDB_sP16_pwmdp_u1__A0_REG EQU CYREG_UDB_W8_A0_03
PWM_PWMUDB_sP16_pwmdp_u1__A1_REG EQU CYREG_UDB_W8_A1_03
PWM_PWMUDB_sP16_pwmdp_u1__D0_D1_REG EQU CYREG_UDB_CAT16_D_03
PWM_PWMUDB_sP16_pwmdp_u1__D0_REG EQU CYREG_UDB_W8_D0_03
PWM_PWMUDB_sP16_pwmdp_u1__D1_REG EQU CYREG_UDB_W8_D1_03
PWM_PWMUDB_sP16_pwmdp_u1__DP_AUX_CTL_REG EQU CYREG_UDB_W8_ACTL_03
PWM_PWMUDB_sP16_pwmdp_u1__F0_F1_REG EQU CYREG_UDB_CAT16_F_03
PWM_PWMUDB_sP16_pwmdp_u1__F0_REG EQU CYREG_UDB_W8_F0_03
PWM_PWMUDB_sP16_pwmdp_u1__F1_REG EQU CYREG_UDB_W8_F1_03

; nEN
nEN__0__DM__MASK EQU 0x38000
nEN__0__DM__SHIFT EQU 15
nEN__0__DR EQU CYREG_PRT0_DR
nEN__0__HSIOM EQU CYREG_HSIOM_PORT_SEL0
nEN__0__HSIOM_MASK EQU 0x00F00000
nEN__0__HSIOM_SHIFT EQU 20
nEN__0__INTCFG EQU CYREG_PRT0_INTCFG
nEN__0__INTSTAT EQU CYREG_PRT0_INTSTAT
nEN__0__MASK EQU 0x20
nEN__0__OUT_SEL EQU CYREG_UDB_PA0_CFG10
nEN__0__OUT_SEL_SHIFT EQU 10
nEN__0__OUT_SEL_VAL EQU 1
nEN__0__PA__CFG0 EQU CYREG_UDB_PA0_CFG0
nEN__0__PA__CFG1 EQU CYREG_UDB_PA0_CFG1
nEN__0__PA__CFG10 EQU CYREG_UDB_PA0_CFG10
nEN__0__PA__CFG11 EQU CYREG_UDB_PA0_CFG11
nEN__0__PA__CFG12 EQU CYREG_UDB_PA0_CFG12
nEN__0__PA__CFG13 EQU CYREG_UDB_PA0_CFG13
nEN__0__PA__CFG14 EQU CYREG_UDB_PA0_CFG14
nEN__0__PA__CFG2 EQU CYREG_UDB_PA0_CFG2
nEN__0__PA__CFG3 EQU CYREG_UDB_PA0_CFG3
nEN__0__PA__CFG4 EQU CYREG_UDB_PA0_CFG4
nEN__0__PA__CFG5 EQU CYREG_UDB_PA0_CFG5
nEN__0__PA__CFG6 EQU CYREG_UDB_PA0_CFG6
nEN__0__PA__CFG7 EQU CYREG_UDB_PA0_CFG7
nEN__0__PA__CFG8 EQU CYREG_UDB_PA0_CFG8
nEN__0__PA__CFG9 EQU CYREG_UDB_PA0_CFG9
nEN__0__PC EQU CYREG_PRT0_PC
nEN__0__PC2 EQU CYREG_PRT0_PC2
nEN__0__PORT EQU 0
nEN__0__PS EQU CYREG_PRT0_PS
nEN__0__SHIFT EQU 5
nEN__DR EQU CYREG_PRT0_DR
nEN__INTCFG EQU CYREG_PRT0_INTCFG
nEN__INTSTAT EQU CYREG_PRT0_INTSTAT
nEN__MASK EQU 0x20
nEN__PA__CFG0 EQU CYREG_UDB_PA0_CFG0
nEN__PA__CFG1 EQU CYREG_UDB_PA0_CFG1
nEN__PA__CFG10 EQU CYREG_UDB_PA0_CFG10
nEN__PA__CFG11 EQU CYREG_UDB_PA0_CFG11
nEN__PA__CFG12 EQU CYREG_UDB_PA0_CFG12
nEN__PA__CFG13 EQU CYREG_UDB_PA0_CFG13
nEN__PA__CFG14 EQU CYREG_UDB_PA0_CFG14
nEN__PA__CFG2 EQU CYREG_UDB_PA0_CFG2
nEN__PA__CFG3 EQU CYREG_UDB_PA0_CFG3
nEN__PA__CFG4 EQU CYREG_UDB_PA0_CFG4
nEN__PA__CFG5 EQU CYREG_UDB_PA0_CFG5
nEN__PA__CFG6 EQU CYREG_UDB_PA0_CFG6
nEN__PA__CFG7 EQU CYREG_UDB_PA0_CFG7
nEN__PA__CFG8 EQU CYREG_UDB_PA0_CFG8
nEN__PA__CFG9 EQU CYREG_UDB_PA0_CFG9
nEN__PC EQU CYREG_PRT0_PC
nEN__PC2 EQU CYREG_PRT0_PC2
nEN__PORT EQU 0
nEN__PS EQU CYREG_PRT0_PS
nEN__SHIFT EQU 5

; I2CS_SCB
I2CS_SCB__BIST_CONTROL EQU CYREG_SCB0_BIST_CONTROL
I2CS_SCB__BIST_DATA EQU CYREG_SCB0_BIST_DATA
I2CS_SCB__CTRL EQU CYREG_SCB0_CTRL
I2CS_SCB__EZ_DATA00 EQU CYREG_SCB0_EZ_DATA00
I2CS_SCB__EZ_DATA01 EQU CYREG_SCB0_EZ_DATA01
I2CS_SCB__EZ_DATA02 EQU CYREG_SCB0_EZ_DATA02
I2CS_SCB__EZ_DATA03 EQU CYREG_SCB0_EZ_DATA03
I2CS_SCB__EZ_DATA04 EQU CYREG_SCB0_EZ_DATA04
I2CS_SCB__EZ_DATA05 EQU CYREG_SCB0_EZ_DATA05
I2CS_SCB__EZ_DATA06 EQU CYREG_SCB0_EZ_DATA06
I2CS_SCB__EZ_DATA07 EQU CYREG_SCB0_EZ_DATA07
I2CS_SCB__EZ_DATA08 EQU CYREG_SCB0_EZ_DATA08
I2CS_SCB__EZ_DATA09 EQU CYREG_SCB0_EZ_DATA09
I2CS_SCB__EZ_DATA10 EQU CYREG_SCB0_EZ_DATA10
I2CS_SCB__EZ_DATA11 EQU CYREG_SCB0_EZ_DATA11
I2CS_SCB__EZ_DATA12 EQU CYREG_SCB0_EZ_DATA12
I2CS_SCB__EZ_DATA13 EQU CYREG_SCB0_EZ_DATA13
I2CS_SCB__EZ_DATA14 EQU CYREG_SCB0_EZ_DATA14
I2CS_SCB__EZ_DATA15 EQU CYREG_SCB0_EZ_DATA15
I2CS_SCB__EZ_DATA16 EQU CYREG_SCB0_EZ_DATA16
I2CS_SCB__EZ_DATA17 EQU CYREG_SCB0_EZ_DATA17
I2CS_SCB__EZ_DATA18 EQU CYREG_SCB0_EZ_DATA18
I2CS_SCB__EZ_DATA19 EQU CYREG_SCB0_EZ_DATA19
I2CS_SCB__EZ_DATA20 EQU CYREG_SCB0_EZ_DATA20
I2CS_SCB__EZ_DATA21 EQU CYREG_SCB0_EZ_DATA21
I2CS_SCB__EZ_DATA22 EQU CYREG_SCB0_EZ_DATA22
I2CS_SCB__EZ_DATA23 EQU CYREG_SCB0_EZ_DATA23
I2CS_SCB__EZ_DATA24 EQU CYREG_SCB0_EZ_DATA24
I2CS_SCB__EZ_DATA25 EQU CYREG_SCB0_EZ_DATA25
I2CS_SCB__EZ_DATA26 EQU CYREG_SCB0_EZ_DATA26
I2CS_SCB__EZ_DATA27 EQU CYREG_SCB0_EZ_DATA27
I2CS_SCB__EZ_DATA28 EQU CYREG_SCB0_EZ_DATA28
I2CS_SCB__EZ_DATA29 EQU CYREG_SCB0_EZ_DATA29
I2CS_SCB__EZ_DATA30 EQU CYREG_SCB0_EZ_DATA30
I2CS_SCB__EZ_DATA31 EQU CYREG_SCB0_EZ_DATA31
I2CS_SCB__I2C_CFG EQU CYREG_SCB0_I2C_CFG
I2CS_SCB__I2C_CTRL EQU CYREG_SCB0_I2C_CTRL
I2CS_SCB__I2C_M_CMD EQU CYREG_SCB0_I2C_M_CMD
I2CS_SCB__I2C_S_CMD EQU CYREG_SCB0_I2C_S_CMD
I2CS_SCB__I2C_STATUS EQU CYREG_SCB0_I2C_STATUS
I2CS_SCB__INTR_CAUSE EQU CYREG_SCB0_INTR_CAUSE
I2CS_SCB__INTR_I2C_EC EQU CYREG_SCB0_INTR_I2C_EC
I2CS_SCB__INTR_I2C_EC_MASK EQU CYREG_SCB0_INTR_I2C_EC_MASK
I2CS_SCB__INTR_I2C_EC_MASKED EQU CYREG_SCB0_INTR_I2C_EC_MASKED
I2CS_SCB__INTR_M EQU CYREG_SCB0_INTR_M
I2CS_SCB__INTR_M_MASK EQU CYREG_SCB0_INTR_M_MASK
I2CS_SCB__INTR_M_MASKED EQU CYREG_SCB0_INTR_M_MASKED
I2CS_SCB__INTR_M_SET EQU CYREG_SCB0_INTR_M_SET
I2CS_SCB__INTR_RX EQU CYREG_SCB0_INTR_RX
I2CS_SCB__INTR_RX_MASK EQU CYREG_SCB0_INTR_RX_MASK
I2CS_SCB__INTR_RX_MASKED EQU CYREG_SCB0_INTR_RX_MASKED
I2CS_SCB__INTR_RX_SET EQU CYREG_SCB0_INTR_RX_SET
I2CS_SCB__INTR_S EQU CYREG_SCB0_INTR_S
I2CS_SCB__INTR_S_MASK EQU CYREG_SCB0_INTR_S_MASK
I2CS_SCB__INTR_S_MASKED EQU CYREG_SCB0_INTR_S_MASKED
I2CS_SCB__INTR_S_SET EQU CYREG_SCB0_INTR_S_SET
I2CS_SCB__INTR_SPI_EC EQU CYREG_SCB0_INTR_SPI_EC
I2CS_SCB__INTR_SPI_EC_MASK EQU CYREG_SCB0_INTR_SPI_EC_MASK
I2CS_SCB__INTR_SPI_EC_MASKED EQU CYREG_SCB0_INTR_SPI_EC_MASKED
I2CS_SCB__INTR_TX EQU CYREG_SCB0_INTR_TX
I2CS_SCB__INTR_TX_MASK EQU CYREG_SCB0_INTR_TX_MASK
I2CS_SCB__INTR_TX_MASKED EQU CYREG_SCB0_INTR_TX_MASKED
I2CS_SCB__INTR_TX_SET EQU CYREG_SCB0_INTR_TX_SET
I2CS_SCB__RX_CTRL EQU CYREG_SCB0_RX_CTRL
I2CS_SCB__RX_FIFO_CTRL EQU CYREG_SCB0_RX_FIFO_CTRL
I2CS_SCB__RX_FIFO_RD EQU CYREG_SCB0_RX_FIFO_RD
I2CS_SCB__RX_FIFO_RD_SILENT EQU CYREG_SCB0_RX_FIFO_RD_SILENT
I2CS_SCB__RX_FIFO_STATUS EQU CYREG_SCB0_RX_FIFO_STATUS
I2CS_SCB__RX_MATCH EQU CYREG_SCB0_RX_MATCH
I2CS_SCB__SPI_CTRL EQU CYREG_SCB0_SPI_CTRL
I2CS_SCB__SPI_STATUS EQU CYREG_SCB0_SPI_STATUS
I2CS_SCB__STATUS EQU CYREG_SCB0_STATUS
I2CS_SCB__TX_CTRL EQU CYREG_SCB0_TX_CTRL
I2CS_SCB__TX_FIFO_CTRL EQU CYREG_SCB0_TX_FIFO_CTRL
I2CS_SCB__TX_FIFO_STATUS EQU CYREG_SCB0_TX_FIFO_STATUS
I2CS_SCB__TX_FIFO_WR EQU CYREG_SCB0_TX_FIFO_WR
I2CS_SCB__UART_CTRL EQU CYREG_SCB0_UART_CTRL
I2CS_SCB__UART_RX_CTRL EQU CYREG_SCB0_UART_RX_CTRL
I2CS_SCB__UART_RX_STATUS EQU CYREG_SCB0_UART_RX_STATUS
I2CS_SCB__UART_TX_CTRL EQU CYREG_SCB0_UART_TX_CTRL

; I2CS_SCB_IRQ
I2CS_SCB_IRQ__INTC_CLR_EN_REG EQU CYREG_CM0_ICER
I2CS_SCB_IRQ__INTC_CLR_PD_REG EQU CYREG_CM0_ICPR
I2CS_SCB_IRQ__INTC_MASK EQU 0x400
I2CS_SCB_IRQ__INTC_NUMBER EQU 10
I2CS_SCB_IRQ__INTC_PRIOR_MASK EQU 0xC00000
I2CS_SCB_IRQ__INTC_PRIOR_NUM EQU 3
I2CS_SCB_IRQ__INTC_PRIOR_REG EQU CYREG_CM0_IPR2
I2CS_SCB_IRQ__INTC_SET_EN_REG EQU CYREG_CM0_ISER
I2CS_SCB_IRQ__INTC_SET_PD_REG EQU CYREG_CM0_ISPR

; I2CS_SCBCLK
I2CS_SCBCLK__DIVIDER_MASK EQU 0x0000FFFF
I2CS_SCBCLK__ENABLE EQU CYREG_CLK_DIVIDER_A00
I2CS_SCBCLK__ENABLE_MASK EQU 0x80000000
I2CS_SCBCLK__MASK EQU 0x80000000
I2CS_SCBCLK__REGISTER EQU CYREG_CLK_DIVIDER_A00

; I2CS_scl
I2CS_scl__0__DM__MASK EQU 0x07
I2CS_scl__0__DM__SHIFT EQU 0
I2CS_scl__0__DR EQU CYREG_PRT4_DR
I2CS_scl__0__HSIOM EQU CYREG_HSIOM_PORT_SEL4
I2CS_scl__0__HSIOM_MASK EQU 0x0000000F
I2CS_scl__0__HSIOM_SHIFT EQU 0
I2CS_scl__0__INTCFG EQU CYREG_PRT4_INTCFG
I2CS_scl__0__INTSTAT EQU CYREG_PRT4_INTSTAT
I2CS_scl__0__MASK EQU 0x01
I2CS_scl__0__PC EQU CYREG_PRT4_PC
I2CS_scl__0__PC2 EQU CYREG_PRT4_PC2
I2CS_scl__0__PORT EQU 4
I2CS_scl__0__PS EQU CYREG_PRT4_PS
I2CS_scl__0__SHIFT EQU 0
I2CS_scl__DR EQU CYREG_PRT4_DR
I2CS_scl__INTCFG EQU CYREG_PRT4_INTCFG
I2CS_scl__INTSTAT EQU CYREG_PRT4_INTSTAT
I2CS_scl__MASK EQU 0x01
I2CS_scl__PC EQU CYREG_PRT4_PC
I2CS_scl__PC2 EQU CYREG_PRT4_PC2
I2CS_scl__PORT EQU 4
I2CS_scl__PS EQU CYREG_PRT4_PS
I2CS_scl__SHIFT EQU 0

; I2CS_sda
I2CS_sda__0__DM__MASK EQU 0x38
I2CS_sda__0__DM__SHIFT EQU 3
I2CS_sda__0__DR EQU CYREG_PRT4_DR
I2CS_sda__0__HSIOM EQU CYREG_HSIOM_PORT_SEL4
I2CS_sda__0__HSIOM_MASK EQU 0x000000F0
I2CS_sda__0__HSIOM_SHIFT EQU 4
I2CS_sda__0__INTCFG EQU CYREG_PRT4_INTCFG
I2CS_sda__0__INTSTAT EQU CYREG_PRT4_INTSTAT
I2CS_sda__0__MASK EQU 0x02
I2CS_sda__0__PC EQU CYREG_PRT4_PC
I2CS_sda__0__PC2 EQU CYREG_PRT4_PC2
I2CS_sda__0__PORT EQU 4
I2CS_sda__0__PS EQU CYREG_PRT4_PS
I2CS_sda__0__SHIFT EQU 1
I2CS_sda__DR EQU CYREG_PRT4_DR
I2CS_sda__INTCFG EQU CYREG_PRT4_INTCFG
I2CS_sda__INTSTAT EQU CYREG_PRT4_INTSTAT
I2CS_sda__MASK EQU 0x02
I2CS_sda__PC EQU CYREG_PRT4_PC
I2CS_sda__PC2 EQU CYREG_PRT4_PC2
I2CS_sda__PORT EQU 4
I2CS_sda__PS EQU CYREG_PRT4_PS
I2CS_sda__SHIFT EQU 1

; STEP
STEP__0__DM__MASK EQU 0x1C0000
STEP__0__DM__SHIFT EQU 18
STEP__0__DR EQU CYREG_PRT0_DR
STEP__0__HSIOM EQU CYREG_HSIOM_PORT_SEL0
STEP__0__HSIOM_MASK EQU 0x0F000000
STEP__0__HSIOM_SHIFT EQU 24
STEP__0__INTCFG EQU CYREG_PRT0_INTCFG
STEP__0__INTSTAT EQU CYREG_PRT0_INTSTAT
STEP__0__MASK EQU 0x40
STEP__0__OUT_SEL EQU CYREG_UDB_PA0_CFG10
STEP__0__OUT_SEL_SHIFT EQU 12
STEP__0__OUT_SEL_VAL EQU 3
STEP__0__PA__CFG0 EQU CYREG_UDB_PA0_CFG0
STEP__0__PA__CFG1 EQU CYREG_UDB_PA0_CFG1
STEP__0__PA__CFG10 EQU CYREG_UDB_PA0_CFG10
STEP__0__PA__CFG11 EQU CYREG_UDB_PA0_CFG11
STEP__0__PA__CFG12 EQU CYREG_UDB_PA0_CFG12
STEP__0__PA__CFG13 EQU CYREG_UDB_PA0_CFG13
STEP__0__PA__CFG14 EQU CYREG_UDB_PA0_CFG14
STEP__0__PA__CFG2 EQU CYREG_UDB_PA0_CFG2
STEP__0__PA__CFG3 EQU CYREG_UDB_PA0_CFG3
STEP__0__PA__CFG4 EQU CYREG_UDB_PA0_CFG4
STEP__0__PA__CFG5 EQU CYREG_UDB_PA0_CFG5
STEP__0__PA__CFG6 EQU CYREG_UDB_PA0_CFG6
STEP__0__PA__CFG7 EQU CYREG_UDB_PA0_CFG7
STEP__0__PA__CFG8 EQU CYREG_UDB_PA0_CFG8
STEP__0__PA__CFG9 EQU CYREG_UDB_PA0_CFG9
STEP__0__PC EQU CYREG_PRT0_PC
STEP__0__PC2 EQU CYREG_PRT0_PC2
STEP__0__PORT EQU 0
STEP__0__PS EQU CYREG_PRT0_PS
STEP__0__SHIFT EQU 6
STEP__DR EQU CYREG_PRT0_DR
STEP__INTCFG EQU CYREG_PRT0_INTCFG
STEP__INTSTAT EQU CYREG_PRT0_INTSTAT
STEP__MASK EQU 0x40
STEP__PA__CFG0 EQU CYREG_UDB_PA0_CFG0
STEP__PA__CFG1 EQU CYREG_UDB_PA0_CFG1
STEP__PA__CFG10 EQU CYREG_UDB_PA0_CFG10
STEP__PA__CFG11 EQU CYREG_UDB_PA0_CFG11
STEP__PA__CFG12 EQU CYREG_UDB_PA0_CFG12
STEP__PA__CFG13 EQU CYREG_UDB_PA0_CFG13
STEP__PA__CFG14 EQU CYREG_UDB_PA0_CFG14
STEP__PA__CFG2 EQU CYREG_UDB_PA0_CFG2
STEP__PA__CFG3 EQU CYREG_UDB_PA0_CFG3
STEP__PA__CFG4 EQU CYREG_UDB_PA0_CFG4
STEP__PA__CFG5 EQU CYREG_UDB_PA0_CFG5
STEP__PA__CFG6 EQU CYREG_UDB_PA0_CFG6
STEP__PA__CFG7 EQU CYREG_UDB_PA0_CFG7
STEP__PA__CFG8 EQU CYREG_UDB_PA0_CFG8
STEP__PA__CFG9 EQU CYREG_UDB_PA0_CFG9
STEP__PC EQU CYREG_PRT0_PC
STEP__PC2 EQU CYREG_PRT0_PC2
STEP__PORT EQU 0
STEP__PS EQU CYREG_PRT0_PS
STEP__SHIFT EQU 6

; cap1
cap1__0__DM__MASK EQU 0xE00000
cap1__0__DM__SHIFT EQU 21
cap1__0__DR EQU CYREG_PRT0_DR
cap1__0__HSIOM EQU CYREG_HSIOM_PORT_SEL0
cap1__0__HSIOM_MASK EQU 0xF0000000
cap1__0__HSIOM_SHIFT EQU 28
cap1__0__INTCFG EQU CYREG_PRT0_INTCFG
cap1__0__INTSTAT EQU CYREG_PRT0_INTSTAT
cap1__0__MASK EQU 0x80
cap1__0__PA__CFG0 EQU CYREG_UDB_PA0_CFG0
cap1__0__PA__CFG1 EQU CYREG_UDB_PA0_CFG1
cap1__0__PA__CFG10 EQU CYREG_UDB_PA0_CFG10
cap1__0__PA__CFG11 EQU CYREG_UDB_PA0_CFG11
cap1__0__PA__CFG12 EQU CYREG_UDB_PA0_CFG12
cap1__0__PA__CFG13 EQU CYREG_UDB_PA0_CFG13
cap1__0__PA__CFG14 EQU CYREG_UDB_PA0_CFG14
cap1__0__PA__CFG2 EQU CYREG_UDB_PA0_CFG2
cap1__0__PA__CFG3 EQU CYREG_UDB_PA0_CFG3
cap1__0__PA__CFG4 EQU CYREG_UDB_PA0_CFG4
cap1__0__PA__CFG5 EQU CYREG_UDB_PA0_CFG5
cap1__0__PA__CFG6 EQU CYREG_UDB_PA0_CFG6
cap1__0__PA__CFG7 EQU CYREG_UDB_PA0_CFG7
cap1__0__PA__CFG8 EQU CYREG_UDB_PA0_CFG8
cap1__0__PA__CFG9 EQU CYREG_UDB_PA0_CFG9
cap1__0__PC EQU CYREG_PRT0_PC
cap1__0__PC2 EQU CYREG_PRT0_PC2
cap1__0__PORT EQU 0
cap1__0__PS EQU CYREG_PRT0_PS
cap1__0__SHIFT EQU 7
cap1__DR EQU CYREG_PRT0_DR
cap1__INTCFG EQU CYREG_PRT0_INTCFG
cap1__INTSTAT EQU CYREG_PRT0_INTSTAT
cap1__MASK EQU 0x80
cap1__PA__CFG0 EQU CYREG_UDB_PA0_CFG0
cap1__PA__CFG1 EQU CYREG_UDB_PA0_CFG1
cap1__PA__CFG10 EQU CYREG_UDB_PA0_CFG10
cap1__PA__CFG11 EQU CYREG_UDB_PA0_CFG11
cap1__PA__CFG12 EQU CYREG_UDB_PA0_CFG12
cap1__PA__CFG13 EQU CYREG_UDB_PA0_CFG13
cap1__PA__CFG14 EQU CYREG_UDB_PA0_CFG14
cap1__PA__CFG2 EQU CYREG_UDB_PA0_CFG2
cap1__PA__CFG3 EQU CYREG_UDB_PA0_CFG3
cap1__PA__CFG4 EQU CYREG_UDB_PA0_CFG4
cap1__PA__CFG5 EQU CYREG_UDB_PA0_CFG5
cap1__PA__CFG6 EQU CYREG_UDB_PA0_CFG6
cap1__PA__CFG7 EQU CYREG_UDB_PA0_CFG7
cap1__PA__CFG8 EQU CYREG_UDB_PA0_CFG8
cap1__PA__CFG9 EQU CYREG_UDB_PA0_CFG9
cap1__PC EQU CYREG_PRT0_PC
cap1__PC2 EQU CYREG_PRT0_PC2
cap1__PORT EQU 0
cap1__PS EQU CYREG_PRT0_PS
cap1__SHIFT EQU 7

; cap2
cap2__0__DM__MASK EQU 0x7000
cap2__0__DM__SHIFT EQU 12
cap2__0__DR EQU CYREG_PRT0_DR
cap2__0__HSIOM EQU CYREG_HSIOM_PORT_SEL0
cap2__0__HSIOM_MASK EQU 0x000F0000
cap2__0__HSIOM_SHIFT EQU 16
cap2__0__INTCFG EQU CYREG_PRT0_INTCFG
cap2__0__INTSTAT EQU CYREG_PRT0_INTSTAT
cap2__0__MASK EQU 0x10
cap2__0__PA__CFG0 EQU CYREG_UDB_PA0_CFG0
cap2__0__PA__CFG1 EQU CYREG_UDB_PA0_CFG1
cap2__0__PA__CFG10 EQU CYREG_UDB_PA0_CFG10
cap2__0__PA__CFG11 EQU CYREG_UDB_PA0_CFG11
cap2__0__PA__CFG12 EQU CYREG_UDB_PA0_CFG12
cap2__0__PA__CFG13 EQU CYREG_UDB_PA0_CFG13
cap2__0__PA__CFG14 EQU CYREG_UDB_PA0_CFG14
cap2__0__PA__CFG2 EQU CYREG_UDB_PA0_CFG2
cap2__0__PA__CFG3 EQU CYREG_UDB_PA0_CFG3
cap2__0__PA__CFG4 EQU CYREG_UDB_PA0_CFG4
cap2__0__PA__CFG5 EQU CYREG_UDB_PA0_CFG5
cap2__0__PA__CFG6 EQU CYREG_UDB_PA0_CFG6
cap2__0__PA__CFG7 EQU CYREG_UDB_PA0_CFG7
cap2__0__PA__CFG8 EQU CYREG_UDB_PA0_CFG8
cap2__0__PA__CFG9 EQU CYREG_UDB_PA0_CFG9
cap2__0__PC EQU CYREG_PRT0_PC
cap2__0__PC2 EQU CYREG_PRT0_PC2
cap2__0__PORT EQU 0
cap2__0__PS EQU CYREG_PRT0_PS
cap2__0__SHIFT EQU 4
cap2__DR EQU CYREG_PRT0_DR
cap2__INTCFG EQU CYREG_PRT0_INTCFG
cap2__INTSTAT EQU CYREG_PRT0_INTSTAT
cap2__MASK EQU 0x10
cap2__PA__CFG0 EQU CYREG_UDB_PA0_CFG0
cap2__PA__CFG1 EQU CYREG_UDB_PA0_CFG1
cap2__PA__CFG10 EQU CYREG_UDB_PA0_CFG10
cap2__PA__CFG11 EQU CYREG_UDB_PA0_CFG11
cap2__PA__CFG12 EQU CYREG_UDB_PA0_CFG12
cap2__PA__CFG13 EQU CYREG_UDB_PA0_CFG13
cap2__PA__CFG14 EQU CYREG_UDB_PA0_CFG14
cap2__PA__CFG2 EQU CYREG_UDB_PA0_CFG2
cap2__PA__CFG3 EQU CYREG_UDB_PA0_CFG3
cap2__PA__CFG4 EQU CYREG_UDB_PA0_CFG4
cap2__PA__CFG5 EQU CYREG_UDB_PA0_CFG5
cap2__PA__CFG6 EQU CYREG_UDB_PA0_CFG6
cap2__PA__CFG7 EQU CYREG_UDB_PA0_CFG7
cap2__PA__CFG8 EQU CYREG_UDB_PA0_CFG8
cap2__PA__CFG9 EQU CYREG_UDB_PA0_CFG9
cap2__PC EQU CYREG_PRT0_PC
cap2__PC2 EQU CYREG_PRT0_PC2
cap2__PORT EQU 0
cap2__PS EQU CYREG_PRT0_PS
cap2__SHIFT EQU 4

; hall
hall__0__DM__MASK EQU 0x38
hall__0__DM__SHIFT EQU 3
hall__0__DR EQU CYREG_PRT0_DR
hall__0__HSIOM EQU CYREG_HSIOM_PORT_SEL0
hall__0__HSIOM_MASK EQU 0x000000F0
hall__0__HSIOM_SHIFT EQU 4
hall__0__INTCFG EQU CYREG_PRT0_INTCFG
hall__0__INTSTAT EQU CYREG_PRT0_INTSTAT
hall__0__MASK EQU 0x02
hall__0__OUT_SEL EQU CYREG_UDB_PA0_CFG10
hall__0__OUT_SEL_SHIFT EQU 2
hall__0__OUT_SEL_VAL EQU 2
hall__0__PA__CFG0 EQU CYREG_UDB_PA0_CFG0
hall__0__PA__CFG1 EQU CYREG_UDB_PA0_CFG1
hall__0__PA__CFG10 EQU CYREG_UDB_PA0_CFG10
hall__0__PA__CFG11 EQU CYREG_UDB_PA0_CFG11
hall__0__PA__CFG12 EQU CYREG_UDB_PA0_CFG12
hall__0__PA__CFG13 EQU CYREG_UDB_PA0_CFG13
hall__0__PA__CFG14 EQU CYREG_UDB_PA0_CFG14
hall__0__PA__CFG2 EQU CYREG_UDB_PA0_CFG2
hall__0__PA__CFG3 EQU CYREG_UDB_PA0_CFG3
hall__0__PA__CFG4 EQU CYREG_UDB_PA0_CFG4
hall__0__PA__CFG5 EQU CYREG_UDB_PA0_CFG5
hall__0__PA__CFG6 EQU CYREG_UDB_PA0_CFG6
hall__0__PA__CFG7 EQU CYREG_UDB_PA0_CFG7
hall__0__PA__CFG8 EQU CYREG_UDB_PA0_CFG8
hall__0__PA__CFG9 EQU CYREG_UDB_PA0_CFG9
hall__0__PC EQU CYREG_PRT0_PC
hall__0__PC2 EQU CYREG_PRT0_PC2
hall__0__PORT EQU 0
hall__0__PS EQU CYREG_PRT0_PS
hall__0__SHIFT EQU 1
hall__DR EQU CYREG_PRT0_DR
hall__INTCFG EQU CYREG_PRT0_INTCFG
hall__INTSTAT EQU CYREG_PRT0_INTSTAT
hall__MASK EQU 0x02
hall__PA__CFG0 EQU CYREG_UDB_PA0_CFG0
hall__PA__CFG1 EQU CYREG_UDB_PA0_CFG1
hall__PA__CFG10 EQU CYREG_UDB_PA0_CFG10
hall__PA__CFG11 EQU CYREG_UDB_PA0_CFG11
hall__PA__CFG12 EQU CYREG_UDB_PA0_CFG12
hall__PA__CFG13 EQU CYREG_UDB_PA0_CFG13
hall__PA__CFG14 EQU CYREG_UDB_PA0_CFG14
hall__PA__CFG2 EQU CYREG_UDB_PA0_CFG2
hall__PA__CFG3 EQU CYREG_UDB_PA0_CFG3
hall__PA__CFG4 EQU CYREG_UDB_PA0_CFG4
hall__PA__CFG5 EQU CYREG_UDB_PA0_CFG5
hall__PA__CFG6 EQU CYREG_UDB_PA0_CFG6
hall__PA__CFG7 EQU CYREG_UDB_PA0_CFG7
hall__PA__CFG8 EQU CYREG_UDB_PA0_CFG8
hall__PA__CFG9 EQU CYREG_UDB_PA0_CFG9
hall__PC EQU CYREG_PRT0_PC
hall__PC2 EQU CYREG_PRT0_PC2
hall__PORT EQU 0
hall__PS EQU CYREG_PRT0_PS
hall__SHIFT EQU 1

; Clock
Clock__DIVIDER_MASK EQU 0x0000FFFF
Clock__ENABLE EQU CYREG_CLK_DIVIDER_B00
Clock__ENABLE_MASK EQU 0x80000000
Clock__MASK EQU 0x80000000
Clock__REGISTER EQU CYREG_CLK_DIVIDER_B00

; nSLEEP
nSLEEP__0__DM__MASK EQU 0x1C0
nSLEEP__0__DM__SHIFT EQU 6
nSLEEP__0__DR EQU CYREG_PRT0_DR
nSLEEP__0__HSIOM EQU CYREG_HSIOM_PORT_SEL0
nSLEEP__0__HSIOM_MASK EQU 0x00000F00
nSLEEP__0__HSIOM_SHIFT EQU 8
nSLEEP__0__INTCFG EQU CYREG_PRT0_INTCFG
nSLEEP__0__INTSTAT EQU CYREG_PRT0_INTSTAT
nSLEEP__0__MASK EQU 0x04
nSLEEP__0__OUT_SEL EQU CYREG_UDB_PA0_CFG10
nSLEEP__0__OUT_SEL_SHIFT EQU 4
nSLEEP__0__OUT_SEL_VAL EQU 0
nSLEEP__0__PA__CFG0 EQU CYREG_UDB_PA0_CFG0
nSLEEP__0__PA__CFG1 EQU CYREG_UDB_PA0_CFG1
nSLEEP__0__PA__CFG10 EQU CYREG_UDB_PA0_CFG10
nSLEEP__0__PA__CFG11 EQU CYREG_UDB_PA0_CFG11
nSLEEP__0__PA__CFG12 EQU CYREG_UDB_PA0_CFG12
nSLEEP__0__PA__CFG13 EQU CYREG_UDB_PA0_CFG13
nSLEEP__0__PA__CFG14 EQU CYREG_UDB_PA0_CFG14
nSLEEP__0__PA__CFG2 EQU CYREG_UDB_PA0_CFG2
nSLEEP__0__PA__CFG3 EQU CYREG_UDB_PA0_CFG3
nSLEEP__0__PA__CFG4 EQU CYREG_UDB_PA0_CFG4
nSLEEP__0__PA__CFG5 EQU CYREG_UDB_PA0_CFG5
nSLEEP__0__PA__CFG6 EQU CYREG_UDB_PA0_CFG6
nSLEEP__0__PA__CFG7 EQU CYREG_UDB_PA0_CFG7
nSLEEP__0__PA__CFG8 EQU CYREG_UDB_PA0_CFG8
nSLEEP__0__PA__CFG9 EQU CYREG_UDB_PA0_CFG9
nSLEEP__0__PC EQU CYREG_PRT0_PC
nSLEEP__0__PC2 EQU CYREG_PRT0_PC2
nSLEEP__0__PORT EQU 0
nSLEEP__0__PS EQU CYREG_PRT0_PS
nSLEEP__0__SHIFT EQU 2
nSLEEP__DR EQU CYREG_PRT0_DR
nSLEEP__INTCFG EQU CYREG_PRT0_INTCFG
nSLEEP__INTSTAT EQU CYREG_PRT0_INTSTAT
nSLEEP__MASK EQU 0x04
nSLEEP__PA__CFG0 EQU CYREG_UDB_PA0_CFG0
nSLEEP__PA__CFG1 EQU CYREG_UDB_PA0_CFG1
nSLEEP__PA__CFG10 EQU CYREG_UDB_PA0_CFG10
nSLEEP__PA__CFG11 EQU CYREG_UDB_PA0_CFG11
nSLEEP__PA__CFG12 EQU CYREG_UDB_PA0_CFG12
nSLEEP__PA__CFG13 EQU CYREG_UDB_PA0_CFG13
nSLEEP__PA__CFG14 EQU CYREG_UDB_PA0_CFG14
nSLEEP__PA__CFG2 EQU CYREG_UDB_PA0_CFG2
nSLEEP__PA__CFG3 EQU CYREG_UDB_PA0_CFG3
nSLEEP__PA__CFG4 EQU CYREG_UDB_PA0_CFG4
nSLEEP__PA__CFG5 EQU CYREG_UDB_PA0_CFG5
nSLEEP__PA__CFG6 EQU CYREG_UDB_PA0_CFG6
nSLEEP__PA__CFG7 EQU CYREG_UDB_PA0_CFG7
nSLEEP__PA__CFG8 EQU CYREG_UDB_PA0_CFG8
nSLEEP__PA__CFG9 EQU CYREG_UDB_PA0_CFG9
nSLEEP__PC EQU CYREG_PRT0_PC
nSLEEP__PC2 EQU CYREG_PRT0_PC2
nSLEEP__PORT EQU 0
nSLEEP__PS EQU CYREG_PRT0_PS
nSLEEP__SHIFT EQU 2

; Counter_1_CounterUDB
Counter_1_CounterUDB_sC16_counterdp_u0__16BIT_A0_REG EQU CYREG_UDB_W16_A0_00
Counter_1_CounterUDB_sC16_counterdp_u0__16BIT_A1_REG EQU CYREG_UDB_W16_A1_00
Counter_1_CounterUDB_sC16_counterdp_u0__16BIT_D0_REG EQU CYREG_UDB_W16_D0_00
Counter_1_CounterUDB_sC16_counterdp_u0__16BIT_D1_REG EQU CYREG_UDB_W16_D1_00
Counter_1_CounterUDB_sC16_counterdp_u0__16BIT_DP_AUX_CTL_REG EQU CYREG_UDB_W16_ACTL_00
Counter_1_CounterUDB_sC16_counterdp_u0__16BIT_F0_REG EQU CYREG_UDB_W16_F0_00
Counter_1_CounterUDB_sC16_counterdp_u0__16BIT_F1_REG EQU CYREG_UDB_W16_F1_00
Counter_1_CounterUDB_sC16_counterdp_u0__32BIT_A0_REG EQU CYREG_UDB_W32_A0_00
Counter_1_CounterUDB_sC16_counterdp_u0__32BIT_A1_REG EQU CYREG_UDB_W32_A1_00
Counter_1_CounterUDB_sC16_counterdp_u0__32BIT_D0_REG EQU CYREG_UDB_W32_D0_00
Counter_1_CounterUDB_sC16_counterdp_u0__32BIT_D1_REG EQU CYREG_UDB_W32_D1_00
Counter_1_CounterUDB_sC16_counterdp_u0__32BIT_DP_AUX_CTL_REG EQU CYREG_UDB_W32_ACTL_00
Counter_1_CounterUDB_sC16_counterdp_u0__32BIT_F0_REG EQU CYREG_UDB_W32_F0_00
Counter_1_CounterUDB_sC16_counterdp_u0__32BIT_F1_REG EQU CYREG_UDB_W32_F1_00
Counter_1_CounterUDB_sC16_counterdp_u0__A0_A1_REG EQU CYREG_UDB_CAT16_A_00
Counter_1_CounterUDB_sC16_counterdp_u0__A0_REG EQU CYREG_UDB_W8_A0_00
Counter_1_CounterUDB_sC16_counterdp_u0__A1_REG EQU CYREG_UDB_W8_A1_00
Counter_1_CounterUDB_sC16_counterdp_u0__D0_D1_REG EQU CYREG_UDB_CAT16_D_00
Counter_1_CounterUDB_sC16_counterdp_u0__D0_REG EQU CYREG_UDB_W8_D0_00
Counter_1_CounterUDB_sC16_counterdp_u0__D1_REG EQU CYREG_UDB_W8_D1_00
Counter_1_CounterUDB_sC16_counterdp_u0__DP_AUX_CTL_REG EQU CYREG_UDB_W8_ACTL_00
Counter_1_CounterUDB_sC16_counterdp_u0__F0_F1_REG EQU CYREG_UDB_CAT16_F_00
Counter_1_CounterUDB_sC16_counterdp_u0__F0_REG EQU CYREG_UDB_W8_F0_00
Counter_1_CounterUDB_sC16_counterdp_u0__F1_REG EQU CYREG_UDB_W8_F1_00
Counter_1_CounterUDB_sC16_counterdp_u1__16BIT_A0_REG EQU CYREG_UDB_W16_A0_01
Counter_1_CounterUDB_sC16_counterdp_u1__16BIT_A1_REG EQU CYREG_UDB_W16_A1_01
Counter_1_CounterUDB_sC16_counterdp_u1__16BIT_D0_REG EQU CYREG_UDB_W16_D0_01
Counter_1_CounterUDB_sC16_counterdp_u1__16BIT_D1_REG EQU CYREG_UDB_W16_D1_01
Counter_1_CounterUDB_sC16_counterdp_u1__16BIT_DP_AUX_CTL_REG EQU CYREG_UDB_W16_ACTL_01
Counter_1_CounterUDB_sC16_counterdp_u1__16BIT_F0_REG EQU CYREG_UDB_W16_F0_01
Counter_1_CounterUDB_sC16_counterdp_u1__16BIT_F1_REG EQU CYREG_UDB_W16_F1_01
Counter_1_CounterUDB_sC16_counterdp_u1__A0_A1_REG EQU CYREG_UDB_CAT16_A_01
Counter_1_CounterUDB_sC16_counterdp_u1__A0_REG EQU CYREG_UDB_W8_A0_01
Counter_1_CounterUDB_sC16_counterdp_u1__A1_REG EQU CYREG_UDB_W8_A1_01
Counter_1_CounterUDB_sC16_counterdp_u1__D0_D1_REG EQU CYREG_UDB_CAT16_D_01
Counter_1_CounterUDB_sC16_counterdp_u1__D0_REG EQU CYREG_UDB_W8_D0_01
Counter_1_CounterUDB_sC16_counterdp_u1__D1_REG EQU CYREG_UDB_W8_D1_01
Counter_1_CounterUDB_sC16_counterdp_u1__DP_AUX_CTL_REG EQU CYREG_UDB_W8_ACTL_01
Counter_1_CounterUDB_sC16_counterdp_u1__F0_F1_REG EQU CYREG_UDB_CAT16_F_01
Counter_1_CounterUDB_sC16_counterdp_u1__F0_REG EQU CYREG_UDB_W8_F0_01
Counter_1_CounterUDB_sC16_counterdp_u1__F1_REG EQU CYREG_UDB_W8_F1_01
Counter_1_CounterUDB_sC16_counterdp_u1__MSK_DP_AUX_CTL_REG EQU CYREG_UDB_CAT16_ACTL_MSK_01
Counter_1_CounterUDB_sC16_counterdp_u1__PER_DP_AUX_CTL_REG EQU CYREG_UDB_CAT16_ACTL_MSK_01
Counter_1_CounterUDB_sSTSReg_rstSts_stsreg__0__MASK EQU 0x01
Counter_1_CounterUDB_sSTSReg_rstSts_stsreg__0__POS EQU 0
Counter_1_CounterUDB_sSTSReg_rstSts_stsreg__1__MASK EQU 0x02
Counter_1_CounterUDB_sSTSReg_rstSts_stsreg__1__POS EQU 1
Counter_1_CounterUDB_sSTSReg_rstSts_stsreg__16BIT_STATUS_AUX_CTL_REG EQU CYREG_UDB_W16_ACTL_01
Counter_1_CounterUDB_sSTSReg_rstSts_stsreg__16BIT_STATUS_REG EQU CYREG_UDB_W16_ST_01
Counter_1_CounterUDB_sSTSReg_rstSts_stsreg__2__MASK EQU 0x04
Counter_1_CounterUDB_sSTSReg_rstSts_stsreg__2__POS EQU 2
Counter_1_CounterUDB_sSTSReg_rstSts_stsreg__5__MASK EQU 0x20
Counter_1_CounterUDB_sSTSReg_rstSts_stsreg__5__POS EQU 5
Counter_1_CounterUDB_sSTSReg_rstSts_stsreg__6__MASK EQU 0x40
Counter_1_CounterUDB_sSTSReg_rstSts_stsreg__6__POS EQU 6
Counter_1_CounterUDB_sSTSReg_rstSts_stsreg__MASK EQU 0x67
Counter_1_CounterUDB_sSTSReg_rstSts_stsreg__MASK_REG EQU CYREG_UDB_W8_MSK_01
Counter_1_CounterUDB_sSTSReg_rstSts_stsreg__MASK_ST_AUX_CTL_REG EQU CYREG_UDB_CAT16_ACTL_MSK_01
Counter_1_CounterUDB_sSTSReg_rstSts_stsreg__PER_ST_AUX_CTL_REG EQU CYREG_UDB_CAT16_ACTL_MSK_01
Counter_1_CounterUDB_sSTSReg_rstSts_stsreg__STATUS_AUX_CTL_REG EQU CYREG_UDB_W8_ACTL_01
Counter_1_CounterUDB_sSTSReg_rstSts_stsreg__STATUS_CNT_REG EQU CYREG_UDB_CAT16_CTL_ST_01
Counter_1_CounterUDB_sSTSReg_rstSts_stsreg__STATUS_CONTROL_REG EQU CYREG_UDB_CAT16_CTL_ST_01
Counter_1_CounterUDB_sSTSReg_rstSts_stsreg__STATUS_REG EQU CYREG_UDB_W8_ST_01

; Control_Reg
Control_Reg_Sync_ctrl_reg__0__MASK EQU 0x01
Control_Reg_Sync_ctrl_reg__0__POS EQU 0
Control_Reg_Sync_ctrl_reg__1__MASK EQU 0x02
Control_Reg_Sync_ctrl_reg__1__POS EQU 1
Control_Reg_Sync_ctrl_reg__16BIT_CONTROL_AUX_CTL_REG EQU CYREG_UDB_W16_ACTL_01
Control_Reg_Sync_ctrl_reg__16BIT_CONTROL_CONTROL_REG EQU CYREG_UDB_W16_CTL_01
Control_Reg_Sync_ctrl_reg__16BIT_CONTROL_COUNT_REG EQU CYREG_UDB_W16_CTL_01
Control_Reg_Sync_ctrl_reg__16BIT_COUNT_CONTROL_REG EQU CYREG_UDB_W16_CTL_01
Control_Reg_Sync_ctrl_reg__16BIT_COUNT_COUNT_REG EQU CYREG_UDB_W16_CTL_01
Control_Reg_Sync_ctrl_reg__16BIT_MASK_MASK_REG EQU CYREG_UDB_W16_MSK_01
Control_Reg_Sync_ctrl_reg__16BIT_MASK_PERIOD_REG EQU CYREG_UDB_W16_MSK_01
Control_Reg_Sync_ctrl_reg__16BIT_PERIOD_MASK_REG EQU CYREG_UDB_W16_MSK_01
Control_Reg_Sync_ctrl_reg__16BIT_PERIOD_PERIOD_REG EQU CYREG_UDB_W16_MSK_01
Control_Reg_Sync_ctrl_reg__CONTROL_AUX_CTL_REG EQU CYREG_UDB_W8_ACTL_01
Control_Reg_Sync_ctrl_reg__CONTROL_REG EQU CYREG_UDB_W8_CTL_01
Control_Reg_Sync_ctrl_reg__CONTROL_ST_REG EQU CYREG_UDB_CAT16_CTL_ST_01
Control_Reg_Sync_ctrl_reg__COUNT_REG EQU CYREG_UDB_W8_CTL_01
Control_Reg_Sync_ctrl_reg__COUNT_ST_REG EQU CYREG_UDB_CAT16_CTL_ST_01
Control_Reg_Sync_ctrl_reg__MASK EQU 0x03
Control_Reg_Sync_ctrl_reg__MASK_CTL_AUX_CTL_REG EQU CYREG_UDB_CAT16_ACTL_MSK_01
Control_Reg_Sync_ctrl_reg__PER_CTL_AUX_CTL_REG EQU CYREG_UDB_CAT16_ACTL_MSK_01
Control_Reg_Sync_ctrl_reg__PERIOD_REG EQU CYREG_UDB_W8_MSK_01

; Miscellaneous
CYDEV_BCLK__HFCLK__HZ EQU 24000000
CYDEV_BCLK__HFCLK__KHZ EQU 24000
CYDEV_BCLK__HFCLK__MHZ EQU 24
CYDEV_BCLK__SYSCLK__HZ EQU 24000000
CYDEV_BCLK__SYSCLK__KHZ EQU 24000
CYDEV_BCLK__SYSCLK__MHZ EQU 24
CYDEV_CHIP_DIE_LEOPARD EQU 1
CYDEV_CHIP_DIE_PANTHER EQU 4
CYDEV_CHIP_DIE_PSOC4A EQU 2
CYDEV_CHIP_DIE_PSOC5LP EQU 5
CYDEV_CHIP_DIE_UNKNOWN EQU 0
CYDEV_CHIP_FAMILY_PSOC3 EQU 1
CYDEV_CHIP_FAMILY_PSOC4 EQU 2
CYDEV_CHIP_FAMILY_PSOC5 EQU 3
CYDEV_CHIP_FAMILY_UNKNOWN EQU 0
CYDEV_CHIP_FAMILY_USED EQU CYDEV_CHIP_FAMILY_PSOC4
CYDEV_CHIP_JTAG_ID EQU 0x04C81193
CYDEV_CHIP_MEMBER_3A EQU 1
CYDEV_CHIP_MEMBER_4A EQU 2
CYDEV_CHIP_MEMBER_4D EQU 3
CYDEV_CHIP_MEMBER_5A EQU 4
CYDEV_CHIP_MEMBER_5B EQU 5
CYDEV_CHIP_MEMBER_UNKNOWN EQU 0
CYDEV_CHIP_MEMBER_USED EQU CYDEV_CHIP_MEMBER_4A
CYDEV_CHIP_DIE_EXPECT EQU CYDEV_CHIP_MEMBER_USED
CYDEV_CHIP_DIE_ACTUAL EQU CYDEV_CHIP_DIE_EXPECT
CYDEV_CHIP_REV_LEOPARD_ES1 EQU 0
CYDEV_CHIP_REV_LEOPARD_ES2 EQU 1
CYDEV_CHIP_REV_LEOPARD_ES3 EQU 3
CYDEV_CHIP_REV_LEOPARD_PRODUCTION EQU 3
CYDEV_CHIP_REV_PANTHER_ES0 EQU 0
CYDEV_CHIP_REV_PANTHER_ES1 EQU 1
CYDEV_CHIP_REV_PANTHER_PRODUCTION EQU 1
CYDEV_CHIP_REV_PSOC4A_ES0 EQU 17
CYDEV_CHIP_REV_PSOC4A_PRODUCTION EQU 17
CYDEV_CHIP_REV_PSOC5LP_ES0 EQU 0
CYDEV_CHIP_REV_PSOC5LP_PRODUCTION EQU 0
CYDEV_CHIP_REVISION_3A_ES1 EQU 0
CYDEV_CHIP_REVISION_3A_ES2 EQU 1
CYDEV_CHIP_REVISION_3A_ES3 EQU 3
CYDEV_CHIP_REVISION_3A_PRODUCTION EQU 3
CYDEV_CHIP_REVISION_4A_ES0 EQU 17
CYDEV_CHIP_REVISION_4A_PRODUCTION EQU 17
CYDEV_CHIP_REVISION_4D_ES0 EQU 0
CYDEV_CHIP_REVISION_4D_PRODUCTION EQU 0
CYDEV_CHIP_REVISION_5A_ES0 EQU 0
CYDEV_CHIP_REVISION_5A_ES1 EQU 1
CYDEV_CHIP_REVISION_5A_PRODUCTION EQU 1
CYDEV_CHIP_REVISION_5B_ES0 EQU 0
CYDEV_CHIP_REVISION_5B_PRODUCTION EQU 0
CYDEV_CHIP_REVISION_USED EQU CYDEV_CHIP_REVISION_4A_PRODUCTION
CYDEV_CHIP_REV_EXPECT EQU CYDEV_CHIP_REVISION_USED
CYDEV_CONFIG_READ_ACCELERATOR EQU 1
CYDEV_CONFIG_UNUSED_IO_AllowButWarn EQU 0
CYDEV_CONFIG_UNUSED_IO EQU CYDEV_CONFIG_UNUSED_IO_AllowButWarn
CYDEV_CONFIG_UNUSED_IO_AllowWithInfo EQU 1
CYDEV_CONFIG_UNUSED_IO_Disallowed EQU 2
CYDEV_CONFIGURATION_COMPRESSED EQU 1
CYDEV_CONFIGURATION_MODE_COMPRESSED EQU 0
CYDEV_CONFIGURATION_MODE EQU CYDEV_CONFIGURATION_MODE_COMPRESSED
CYDEV_CONFIGURATION_MODE_DMA EQU 2
CYDEV_CONFIGURATION_MODE_UNCOMPRESSED EQU 1
CYDEV_DEBUG_PROTECT_KILL EQU 4
CYDEV_DEBUG_PROTECT_OPEN EQU 1
CYDEV_DEBUG_PROTECT EQU CYDEV_DEBUG_PROTECT_OPEN
CYDEV_DEBUG_PROTECT_PROTECTED EQU 2
CYDEV_DEBUGGING_DPS_Disable EQU 3
CYDEV_DEBUGGING_DPS_SWD EQU 2
CYDEV_DEBUGGING_DPS EQU CYDEV_DEBUGGING_DPS_SWD
CYDEV_DEBUGGING_ENABLE EQU 1
CYDEV_HEAP_SIZE EQU 0x0100
CYDEV_PROJ_TYPE EQU 0
CYDEV_PROJ_TYPE_BOOTLOADER EQU 1
CYDEV_PROJ_TYPE_LOADABLE EQU 2
CYDEV_PROJ_TYPE_MULTIAPPBOOTLOADER EQU 3
CYDEV_PROJ_TYPE_STANDARD EQU 0
CYDEV_STACK_SIZE EQU 0x0400
CYDEV_USE_BUNDLED_CMSIS EQU 1
CYDEV_VARIABLE_VDDA EQU 1
CYDEV_VDDA_MV EQU 3300
CYDEV_VDDD_MV EQU 3300
CYIPBLOCK_M0S8_CTBM_VERSION EQU 0
CYIPBLOCK_m0s8cpuss_VERSION EQU 0
CYIPBLOCK_m0s8csd_VERSION EQU 0
CYIPBLOCK_m0s8gpio2_VERSION EQU 0
CYIPBLOCK_m0s8hsiom4a_VERSION EQU 0
CYIPBLOCK_m0s8lcd_VERSION EQU 0
CYIPBLOCK_m0s8lpcomp_VERSION EQU 0
CYIPBLOCK_m0s8pclk_VERSION EQU 0
CYIPBLOCK_m0s8sar_VERSION EQU 0
CYIPBLOCK_m0s8scb_VERSION EQU 0
CYIPBLOCK_m0s8srssv2_VERSION EQU 1
CYIPBLOCK_m0s8tcpwm_VERSION EQU 0
CYIPBLOCK_m0s8udbif_VERSION EQU 0
CYIPBLOCK_S8_GPIO_VERSION EQU 2
CYDEV_BOOTLOADER_ENABLE EQU 0
    ENDIF
    END
